/*@!Encoding:1252*/
/*

@requirement/s
[PO_01_RS_85845]
IF «    "Ident_SensorID" == ['ECU1'| 'ECU9']  »,
  AND
    "DiagCodingPlattformVW02" == ['1: MQB37W']
THEN: «
           the function "Warning Algorithms Input Interface Conversion Function" shall
            «set 
"DTC_DTC0xF50026StatusByte"
 and 
"DTC_DTC0xF50027StatusByte" 
:=              
 (0xEF & (VW_DTC0xE000EDStatusByte | VW_DTC0xE000A8StatusByte | VW_DTC0xD00017StatusByte | VW_DTC0xD00019StatusByte | VW_DTC0xE000B6StatusByte)) 
| (0x10 & (VW_DTC0xE000EDStatusByte & VW_DTC0xE000A8StatusByte & VW_DTC0xD00017StatusByte & VW_DTC0xD00019StatusByte & VW_DTC0xE000B6StatusByte)))».

------------------------------------------------------------------------------------------------------------------------------------------------
// @SW release : RC_CUST_DAS_VW_02_01_SW_U077.01.01
@date : Dec 13 2022
@author : Mahesh
@observations :
------------------------------------------------------------------------------------------------------------------------------------------------
@date : May 16 2023
@Update : Deepika Tailor
@SW_Release : RC_CUST_DAS_VW_02_U080.01.01
------------------------------------------------------------------------------------------------------------------------------------------------
// @SW release : RC_CUST_DAS_VW_02_01_SW_U154.01.01 - ASPICE 
@date : September 16 2024
@author : Hua Truong
------------------------------------------------------------------------------------------------------------------------------------------------
// @SW release : RC_CUST_DAS_VW_02_SW_U171.01.01
@date : 24 Dec 2024
@author : Hoang Viet
@observations :
------------------------------------------------------------------------------------------------------------------------------------------------
// @SW release : RC_CUST_DAS_VW_02_SW_U190.01.01
@date : 06 May 2025
@author : Nguyen Loc
@observations :
------------------------------------------------------------------------------------------------------------------------------------------------

@Test design

The function "Warning Algorithms Input Interface Conversion Function" shall performs as following

***ECU1
*Testcase 1:
- Set:
	"Ident_SensorID" == 'ECU1'
	"DiagCodingPlattformVW02" == ['1: MQB37W']
- Check:
	"DTC_DTC0xF50026StatusByte" := (0xEF & (VW_DTC0xE000EDStatusByte | VW_DTC0xE000A8StatusByte | VW_DTC0xD00017StatusByte | VW_DTC0xD00019StatusByte | VW_DTC0xE000B6StatusByte)) 
| (0x10 & (VW_DTC0xE000EDStatusByte & VW_DTC0xE000A8StatusByte & VW_DTC0xD00017StatusByte & VW_DTC0xD00019StatusByte & VW_DTC0xE000B6StatusByte)))
	 "DTC_DTC0xF50027StatusByte" := (0xEF & (VW_DTC0xE000EDStatusByte | VW_DTC0xE000A8StatusByte | VW_DTC0xD00017StatusByte | VW_DTC0xD00019StatusByte | VW_DTC0xE000B6StatusByte)) 
| (0x10 & (VW_DTC0xE000EDStatusByte & VW_DTC0xE000A8StatusByte & VW_DTC0xD00017StatusByte & VW_DTC0xD00019StatusByte & VW_DTC0xE000B6StatusByte)))	

***ECU9
*Testcase 2:
- Set:
	"Ident_SensorID" == 'ECU9'
	"DiagCodingPlattformVW02" == ['1: MQB37W']
- Check:
	"DTC_DTC0xF50026StatusByte" := (0xEF & (VW_DTC0xE000EDStatusByte | VW_DTC0xE000A8StatusByte | VW_DTC0xD00017StatusByte | VW_DTC0xD00019StatusByte | VW_DTC0xE000B6StatusByte)) 
| (0x10 & (VW_DTC0xE000EDStatusByte & VW_DTC0xE000A8StatusByte & VW_DTC0xD00017StatusByte & VW_DTC0xD00019StatusByte & VW_DTC0xE000B6StatusByte)))
	 "DTC_DTC0xF50027StatusByte" := (0xEF & (VW_DTC0xE000EDStatusByte | VW_DTC0xE000A8StatusByte | VW_DTC0xD00017StatusByte | VW_DTC0xD00019StatusByte | VW_DTC0xE000B6StatusByte)) 
| (0x10 & (VW_DTC0xE000EDStatusByte & VW_DTC0xE000A8StatusByte & VW_DTC0xD00017StatusByte & VW_DTC0xD00019StatusByte & VW_DTC0xE000B6StatusByte)))							  

***Negative case
*Testcase 3:
- Set:
	"Ident_SensorID" = 'ECU1'
-	"DiagCodingPlattformVW02" <> ['1: MQB37W']
	"DTC_DTC0xF50026StatusByte" = 1
	"DTC_DTC0xF50027StatusByte" = 1
	"VW_DTC0xE000EDStatusByte"  = 0
	"VW_DTC0xE000A8StatusByte"  = 0
	"VW_DTC0xD00017StatusByte"  = 0
	"VW_DTC0xD00019StatusByte"  = 0
	"VW_DTC0xE000B6StatusByte"  = 0
- Check:
	Value of DTC_DTC0xF50026StatusByte  and DTC_DTC0xF50027StatusByte is keep with previous cycle
	"DTC_DTC0xF50026StatusByte = 1
	"DTC_DTC0xF50027StatusByte = 1
  
*Testcase 4:
- Set:
	"Ident_SensorID" != 'ECU1'
	 "Ident_SensorID" != 'ECU9'
-	"DiagCodingPlattformVW02" == ['1: MQB37W']
	"DTC_DTC0xF50026StatusByte" = 1
	"DTC_DTC0xF50027StatusByte" = 1
	"VW_DTC0xE000EDStatusByte"  = 0
	"VW_DTC0xE000A8StatusByte"  = 0
	"VW_DTC0xD00017StatusByte"  = 0
	"VW_DTC0xD00019StatusByte"  = 0
	"VW_DTC0xE000B6StatusByte"  = 0
- Check:
	Value of DTC_DTC0xF50026StatusByte  and DTC_DTC0xF50027StatusByte is keep with previous cycle
	"DTC_DTC0xF50026StatusByte = 1
	"DTC_DTC0xF50027StatusByte = 1
  
*/
testcase SwT_VW_02_6683()
{
	const int NUMBER_OF_TESTCASE=4;
    int i,j,sensorID;
    char reportfile[255];
	int Ident_SensorID[NUMBER_OF_TESTCASE]={1,9,1,0};
	int DTC_DTC0xF50026StatusByte[NUMBER_OF_TESTCASE]	={1,1,1,1};
	int DTC_DTC0xF50027StatusByte[NUMBER_OF_TESTCASE]	={1,1,1,1};
	int VW_DTC0xE000EDStatusByte[NUMBER_OF_TESTCASE]	={1,2,0,0};
	int VW_DTC0xE000A8StatusByte[NUMBER_OF_TESTCASE]	={2,4,0,0};
	int VW_DTC0xD00017StatusByte[NUMBER_OF_TESTCASE]	={3,6,0,0};
	int VW_DTC0xD00019StatusByte[NUMBER_OF_TESTCASE]	={4,8,0,0};
	int VW_DTC0xE000B6StatusByte[NUMBER_OF_TESTCASE]	={5,1,0,0};
	int ouput[NUMBER_OF_TESTCASE]						={0,0,1,1};
	long DTC[5]={
				0xE000ED,
				0xE000A8,
				0xD00017,
				0xD00019,
				0xE000B6
				};

	//********************************************* Preconditions *********************************************
    funcIDE_DeleteAllBP();
    funcIDE_Reset(); 
    // funcIDE_Run();
    //func_wait(3000);

	sensorID = funcIDE_ReadVariable("Rte_SensorId_SensorId_SensorId");
	snprintf(reportfile, 255, "X:\\30_Reports\\Cust\\SwT_VW_02_6683_ECU%d", sensorID);
	TestCaseTitle("SwT_VW_02_6683","Check that function 'Warning Algorithms Input Interface Conversion Function' shall sets 'DTC_DTC0xF50026StatusByte' and 'DTC_DTC0xF50027StatusByte' correctly");
	testReportFileName(reportfile);

	
    /////////////////////**************** End Preconditions ******************
	for (i=0;i<NUMBER_OF_TESTCASE;i++)
	{
		while (Ident_SensorID[i] != sensorID)
		{
			if (0 ==Ident_SensorID[i])
			{
				break;
			}
			i++;
		}

		testStep("+++" , "+++ SECTION: ------------------------------------CASE %d------------------------------------",i+1);
		if (2<=i)
		{
				j=1;
				func_Wait(300);
				// funcWinIdea_SetBPSource("WaAstechCust_DemCbkDTCStatusChanged", "switch (DTC)");
				funcIDE_SetBPLine(63,"Y:/Source/WarnAlgoAstechCust/Variant_DAS_VW_02/WaAstechCust_DtcStatus.c");
				funcIDE_Run();
				funcIDE_WaitForHalt(15000);

				//write VW DTC
				funcIDE_WriteVariable("DTC", DTC[j]);
				func_wait(300);

				funcWinIdea_SetBPSource("WaAstechCust_Wrapper_Write_DTC_0xF50026_0xF50027", "if ((SENSORID_ECU1 == sensorId_en) || (SENSORID_ECU9 == sensorId_en))");
				funcIDE_Run();
				funcIDE_WaitForHalt(5000);
        if (i==NUMBER_OF_TESTCASE-1)
				  funcIDE_WriteVariable("sensorId_en",0);
        else
          funcIDE_WriteVariable("(CodingData_st).platform_en",3); //MEB
				func_wait(300);
				funcIDE_WriteVariable("DTCChanged_Wrapper_Status_st.Buffer_DTC_0xE000A8_StatusByte_u8",VW_DTC0xE000A8StatusByte[i]);
				funcIDE_WriteVariable("DTCChanged_Wrapper_Status_st.Buffer_DTC_0xD00017_StatusByte_u8",VW_DTC0xD00017StatusByte[i]);
				funcIDE_WriteVariable("DTCChanged_Wrapper_Status_st.Buffer_DTC_0xD00019_StatusByte_u8",VW_DTC0xD00019StatusByte[i]);
				func_wait(300);
				funcIDE_WriteVariable("DTCChanged_Wrapper_Status_st.Buffer_DTC_0xE000ED_StatusByte_u8",VW_DTC0xE000EDStatusByte[i]);
				funcIDE_WriteVariable("DTCChanged_Wrapper_Status_st.Buffer_DTC_0xE000B6_StatusByte_u8",VW_DTC0xE000B6StatusByte[i]);
				funcIDE_WriteVariable("Rte_WaAstechCust_DTCStatusList_DTC_0xF50026",DTC_DTC0xF50026StatusByte[i]);
				funcIDE_WriteVariable("Rte_WaAstechCust_DTCStatusList_DTC_0xF50027",DTC_DTC0xF50027StatusByte[i]);


				funcWinIdea_RunToReturn();
				//check DTC_DTC0xF50026StatusByte
				funcIDE_ReadVariableandCheck("Rte_WaAstechCust_DTCStatusList_DTC_0xF50026", ouput[i], equal);
				func_wait(300);
				//check DTC_DTC0xF50027StatusByte
				funcIDE_ReadVariableandCheck("Rte_WaAstechCust_DTCStatusList_DTC_0xF50027", ouput[i], equal);

				funcide_deleteallbp();
				funcide_reset(); 
				funcide_run();
				func_wait(3000);
				funcide_reset(); 

		}
		else
		{
			for (j=0;j<5;j++)
			{
				func_Wait(300);
				// funcWinIdea_SetBPSource("WaAstechCust_DemCbkDTCStatusChanged", "switch (DTC)");
				funcIDE_SetBPLine(63,"Y:/Source/WarnAlgoAstechCust/Variant_DAS_VW_02/WaAstechCust_DtcStatus.c");
				funcIDE_Run();
				funcIDE_WaitForHalt(15000);

				//write VW DTC
				funcIDE_WriteVariable("DTC", DTC[j]);
				func_wait(300);

				funcWinIdea_SetBPSource("WaAstechCust_Wrapper_Write_DTC_0xF50026_0xF50027", "DTCChanged_Status_st.Buffer_DTC_0xF50026_StatusByte_u8 = (WAASTECHCUST_DTC_OR_VALUE");
				funcIDE_Run();
				funcIDE_WaitForHalt(5000);
				func_wait(300);
				funcIDE_WriteVariable("DTCChanged_Wrapper_Status_st.Buffer_DTC_0xE000A8_StatusByte_u8",VW_DTC0xE000A8StatusByte[i]);
				funcIDE_WriteVariable("DTCChanged_Wrapper_Status_st.Buffer_DTC_0xD00017_StatusByte_u8",VW_DTC0xD00017StatusByte[i]);
				funcIDE_WriteVariable("DTCChanged_Wrapper_Status_st.Buffer_DTC_0xD00019_StatusByte_u8",VW_DTC0xD00019StatusByte[i]);
				func_wait(300);
				funcIDE_WriteVariable("DTCChanged_Wrapper_Status_st.Buffer_DTC_0xE000ED_StatusByte_u8",VW_DTC0xE000EDStatusByte[i]);
				funcIDE_WriteVariable("DTCChanged_Wrapper_Status_st.Buffer_DTC_0xE000B6_StatusByte_u8",VW_DTC0xE000B6StatusByte[i]);
				funcIDE_WriteVariable("Rte_WaAstechCust_DTCStatusList_DTC_0xF50026",DTC_DTC0xF50026StatusByte[i]);
				funcIDE_WriteVariable("Rte_WaAstechCust_DTCStatusList_DTC_0xF50027",DTC_DTC0xF50027StatusByte[i]);
				
				
				funcWinIdea_RunToReturn();

					//check DTC_DTC0xF50026StatusByte
					funcIDE_ReadVariableandCheck("Rte_WaAstechCust_DTCStatusList_DTC_0xF50026", ((0xEF & (VW_DTC0xE000A8StatusByte[i] | VW_DTC0xD00017StatusByte[i] | VW_DTC0xD00019StatusByte[i] | VW_DTC0xE000EDStatusByte[i] | VW_DTC0xE000B6StatusByte[i])) | 
																								(0x10 & (VW_DTC0xE000A8StatusByte[i] & VW_DTC0xD00017StatusByte[i] & VW_DTC0xD00019StatusByte[i] & VW_DTC0xE000EDStatusByte[i] & VW_DTC0xE000B6StatusByte[i]))), equal);
					func_wait(300);
					//check DTC_DTC0xF50027StatusByte
					funcIDE_ReadVariableandCheck("Rte_WaAstechCust_DTCStatusList_DTC_0xF50027", ((0xEF & (VW_DTC0xE000A8StatusByte[i] | VW_DTC0xD00017StatusByte[i] | VW_DTC0xD00019StatusByte[i] | VW_DTC0xE000EDStatusByte[i] | VW_DTC0xE000B6StatusByte[i])) | 
																								(0x10 & (VW_DTC0xE000A8StatusByte[i] & VW_DTC0xD00017StatusByte[i] & VW_DTC0xD00019StatusByte[i] & VW_DTC0xE000EDStatusByte[i] & VW_DTC0xE000B6StatusByte[i]))), equal);
					func_wait(300);



				//RESET BP
				funcide_deleteallbp();
				funcide_reset(); 
				funcide_run();
				func_wait(3000);
				funcide_reset(); 
			}
		}
		//RESET BP
		funcide_deleteallbp();
		funcide_reset(); 
		funcide_run();
		func_wait(3000);
		funcide_reset(); 
	}
  	
	//********************************************* End ************************************************
    func_testStepSubSection("Clean Testcase");
    funcIDE_DeleteAllBP();
    funcIDE_Reset();
    funcIDE_Run();
    func_Wait(2000);
}
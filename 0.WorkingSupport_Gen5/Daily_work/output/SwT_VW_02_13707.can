/*@!Encoding:1252*/
/*
[PO_01_RS_102365]
The function "PerceptionInfo Customizing Function" shall «open a MessageReleaseWindow between 44ms and 53ms after the last message was sent».

/*the MessageReleaseWindow is the time window where we are allowed to send a message */
/*
---------------------------------------------------------------------------
@author: Ly Nhi
@release: RC_CUST_DAS_VW_02_SW_U175.01.01
@date: 27 March 2025
---------------------------------------------------------------------------
@author: Nguyen Loc
@release: RC_CUST_DAS_VW_02_SW_U190.01.01
@date: 7 Map 2025
---------------------------------------------------------------------------
The function "PerceptionInfo Customizing Function" shall performs as following:

*CASE 1:
sensors without a sync faillure
Verify that after call of Vda_Ost_TxPerceptionInfo --> 
Vda_OnEarliestPreceptionInfoOutputAlarm function is called 44ms after transmission

*CASE 2:
Provoke a sync failure on one sensor
Verify that after call of Vda_Ost_TxPerceptionInfo --> 
Vda_OnLatesPreceptionInfoOutputAlarm function is called 53ms after transmission
*/
includes
{
}

variables
{
    int var1,var2,var3;

}

testcase SwT_VW_02_13707()
{
	int time0,time1,time2,timef;
	int early = 44;
	int latest = 53;
	testReportFileName("X:\\30_Reports\\Customization\\SwT_VW_02_13707");
	TestCaseTitle("SwT_VW_02_13707","Check that MessageReleaseWindow open in time as test design");  
    funcIDE_DeleteAllBP();
    funcIDE_Reset();
    func_Wait(1000);
	funcIDE_Run();
	func_Wait(3000);
	
	func_testStepSubSection("----------------------------------CASE 1----------------------------------");
	funcWinIdea_SetBPSource("Vda_Ost_TxPerceptionInfo","if(RTE_E_OK == retVal_ReadSensor_u8)"); 
	funcIDE_WaitForHalt(5000);
	
	time0 = func_GetTimeStamp();
	func_wait(1000);
  
	funcIDE_DeleteAllBP();
	func_wait(1000);

	funcWinIdea_SetBPSource("Vda_OnEarliestPerceptionInfoOutputAlarm","(void)SetRelAlarm(Alarm_Vda_LatestPerceptionInfoOutput,"); 
	funcIDE_Run();
	funcIDE_WaitForHalt(5000);

	time1 = func_GetTimeStamp();
	timef = time1 - time0;
	write("time 1: %d",timef);
	if(timef<=early){
		testStepPass("Received in the time frame");
	}
	else{
		testStepFail("NOK");
	}

    funcIDE_DeleteAllBP();
    funcIDE_Reset();
    func_Wait(1000);
	funcIDE_Run();
	func_Wait(3000);
	
	func_testStepSubSection("----------------------------------CASE 2----------------------------------");
	testWaitForTesterConfirmation("Turn off other sensor to perform Sync failure", 10000);
	funcWinIdea_SetBPSource("Vda_Ost_TxPerceptionInfo","if(RTE_E_OK == retVal_ReadSensor_u8)"); 
	funcIDE_WaitForHalt(5000);
	
	time0 = func_GetTimeStamp();
	func_wait(1000);
  
	funcIDE_DeleteAllBP();
	func_wait(1000);
	
	funcWinIdea_SetBPSource("Vda_OnLatestPerceptionInfoOutputAlarm","if(FALSE == Vda_EarliestAlarmIsRunning_b)"); 
	funcIDE_Run();
	funcIDE_WaitForHalt(5000);

	time2 = func_GetTimeStamp();
	timef = time2 - time0;
	write("time 2: %d",timef);
	
	if(timef<=latest){
		testStepPass("Received in the time frame");
	}
	else{
		testStepFail("NOK");
	}

    funcIDE_DeleteAllBP();
	testWaitForTesterConfirmation("Turn on other sensor", 10000);
    funcIDE_Reset();
    func_Wait(1000);
	funcIDE_Run();
	func_Wait(3000);

}
/*@!Encoding:1252*/
includes
{
  
}
/*
[PO_01_RS_83184]
IF
	«(
	("Ident_SensorID" equal to 'ECU0'| 'ECU1'| 'ECU8'|'ECU9' and "DiagCodingPlattformVW02" == '1: MQB37W') 
	or 
	("Ident_SensorID" equal to 'ECU1' | 'ECU9' and "DiagCodingPlattformVW02" == '3: MEB')
	)»
and
	«"EgoVehicle_IgnitionStatus" == 'IgnitionOn' or  "Cust_ASW_Status" == '1: Cx1_Aktiv'  longer than 2 seconds»
and	
	«"Cust_CodingDataEcuForDrawBar" == '2: installed'»
and
	«Anhaenger_01_XIX_FASCANFD1 message is not received for 1000 ms»	,
THEN:
	«The function "Vehicle Bus Normalization (VBN) EDF" shall set "Cust_VBNAnhaenger_01_XIX_FASCANFD2LostCommError" to 'Detected'»
ELSE:
	«The function "Vehicle Bus Normalization (VBN) EDF" shall set "Cust_VBNAnhaenger_01_XIX_FASCANFD2LostCommError" to 'NotDetected'».
/*
  Remark: The signal "AAG_Anhaenger_erkannt" is used for timeout detection of this message.
  hint: The configuration of the related DTC to the Event above in DEM, shall not confugure "Cust_DSCDTCEnableConditionKL15" as EnableCondition in case of IgnitionOFF
 */
/*
--------------------------------------------------------------------------------------------------------
// @SW release : RC_CUST_DAS_VW_02_SW_U190.01.01
@date : May 8 2025
@author : Ly Nhi
@observations :
--------------------------------------------------------------------------------------------------------

@Test_Decription:
The function "Vehicle Bus Normalization (VBN) EDF" shall performs as following:
Testcase [1, 7]: ECU0 with MQB coding
Testcase [8, 14]: ECU1 with MQB coding
Testcase [15, 21]: ECU8 with MQB coding
Testcase [22, 28]: ECU9 with MQB coding
Testcase 29: other ECU with MQB coding
Testcase [30, 36]: ECU1 with MEB coding
Testcase [37, 43]: ECU9 with MEB coding
Testcase 44: other ECU with MEB coding

*Testcase 1/8/15/22:
Set:
- "Ident_SensorID" := 'ECU0'| 'ECU1'| 'ECU8'|'ECU9'
- "DiagCodingPlattformVW02" == '1: MQB37W'
- "EgoVehicle_IgnitionStatus" == 'IgnitionOn
- "Cust_ASW_Status" <> '1: Cx1_Aktiv'  longer than 2 seconds
- "Cust_CodingDataEcuForDrawBar" == '2: installed'
- Anhaenger_01_XIX_FASCANFD1 message is not received for 1000 ms
Check:
- "Cust_VBNAnhaenger_01_XIX_FASCANFD2LostCommError" to 'Detected'

*Testcase 2/9/16/23:
Set:
- "Ident_SensorID" := 'ECU0'| 'ECU1'| 'ECU8'|'ECU9'
- "DiagCodingPlattformVW02" == '1: MQB37W'
- "EgoVehicle_IgnitionStatus" <> 'IgnitionOn
- "Cust_ASW_Status" == '1: Cx1_Aktiv'  longer than 2 seconds
- "Cust_CodingDataEcuForDrawBar" == '2: installed'
- Anhaenger_01_XIX_FASCANFD1 message is not received for 1000 ms
Check:
- "Cust_VBNAnhaenger_01_XIX_FASCANFD2LostCommError" to 'Detected'

*Testcase 3/10/17/24:
Set:
- "Ident_SensorID" := 'ECU0'| 'ECU1'| 'ECU8'|'ECU9'
- "DiagCodingPlattformVW02" == '1: MQB37W'
- "EgoVehicle_IgnitionStatus" == 'IgnitionOn
- "Cust_ASW_Status" <> '1: Cx1_Aktiv'  longer than 2 seconds
- "Cust_CodingDataEcuForDrawBar" == '2: installed'
- Anhaenger_01_XIX_FASCANFD1 message is received for 1000 ms
Check:
- "Cust_VBNAnhaenger_01_XIX_FASCANFD2LostCommError" to 'NotDetected'

*Testcase 4/11/18/25:
Set:
- "Ident_SensorID" := 'ECU0'| 'ECU1'| 'ECU8'|'ECU9'
- "DiagCodingPlattformVW02" == '1: MQB37W'
- "EgoVehicle_IgnitionStatus" == 'IgnitionOn
- "Cust_ASW_Status" <> '1: Cx1_Aktiv'  longer than 2 seconds
- "Cust_CodingDataEcuForDrawBar" <> '2: installed'
- Anhaenger_01_XIX_FASCANFD1 message is not received for 1000 ms
Check:
- "Cust_VBNAnhaenger_01_XIX_FASCANFD2LostCommError" to 'NotDetected'

*Testcase 5/12/19/26:
Set:
- "Ident_SensorID" := 'ECU0'| 'ECU1'| 'ECU8'|'ECU9'
- "DiagCodingPlattformVW02" == '1: MQB37W'
- "EgoVehicle_IgnitionStatus" <> 'IgnitionOn
- "Cust_ASW_Status" == '1: Cx1_Aktiv'  shorter than 2 seconds
- "Cust_CodingDataEcuForDrawBar" == '2: installed'
- Anhaenger_01_XIX_FASCANFD1 message is not received for 1000 ms
Check:
- "Cust_VBNAnhaenger_01_XIX_FASCANFD2LostCommError" to 'NotDetected'

*Testcase 6/13/20/27:
Set:
- "Ident_SensorID" := 'ECU0'| 'ECU1'| 'ECU8'|'ECU9'
- "DiagCodingPlattformVW02" == '1: MQB37W'
- "EgoVehicle_IgnitionStatus" <> 'IgnitionOn
- "Cust_ASW_Status" <> '1: Cx1_Aktiv'
- "Cust_CodingDataEcuForDrawBar" == '2: installed'
- Anhaenger_01_XIX_FASCANFD1 message is not received for 1000 ms
Check:
- "Cust_VBNAnhaenger_01_XIX_FASCANFD2LostCommError" to 'NotDetected'

*Testcase 7/14/21/28:
Set:
- "Ident_SensorID" := 'ECU0'| 'ECU1'| 'ECU8'|'ECU9'
- "DiagCodingPlattformVW02" <> '1: MQB37W' ---> should be not coded
- "EgoVehicle_IgnitionStatus" == 'IgnitionOn
- "Cust_ASW_Status" <> '1: Cx1_Aktiv'  longer than 2 seconds
- "Cust_CodingDataEcuForDrawBar" == '2: installed'
- Anhaenger_01_XIX_FASCANFD1 message is not received for 1000 ms
Check:
- "Cust_VBNAnhaenger_01_XIX_FASCANFD2LostCommError" to 'NotDetected'

*Testcase 29:
Set:
- "Ident_SensorID" <> 'ECU0'| 'ECU1'| 'ECU8'|'ECU9'
- "DiagCodingPlattformVW02" == '1: MQB37W'
- "EgoVehicle_IgnitionStatus" == 'IgnitionOn
- "Cust_ASW_Status" <> '1: Cx1_Aktiv'  longer than 2 seconds
- "Cust_CodingDataEcuForDrawBar" == '2: installed'
- Anhaenger_01_XIX_FASCANFD1 message is not received for 1000 ms
Check:
- "Cust_VBNAnhaenger_01_XIX_FASCANFD2LostCommError" to 'NotDetected'

*Testcase 30/37:
Set:
- "Ident_SensorID" := 'ECU1' | 'ECU9'
- "DiagCodingPlattformVW02" == '3: MEB'
- "EgoVehicle_IgnitionStatus" == 'IgnitionOn
- "Cust_ASW_Status" <> '1: Cx1_Aktiv'  longer than 2 seconds
- "Cust_CodingDataEcuForDrawBar" == '2: installed'
- Anhaenger_01_XIX_FASCANFD1 message is not received for 1000 ms
Check:
- "Cust_VBNAnhaenger_01_XIX_FASCANFD2LostCommError" to 'Detected'

*Testcase 31/38:
Set:
- "Ident_SensorID" := 'ECU1' | 'ECU9'
- "DiagCodingPlattformVW02" == '3: MEB'
- "EgoVehicle_IgnitionStatus" <> 'IgnitionOn
- "Cust_ASW_Status" == '1: Cx1_Aktiv'  longer than 2 seconds
- "Cust_CodingDataEcuForDrawBar" == '2: installed'
- Anhaenger_01_XIX_FASCANFD1 message is not received for 1000 ms
Check:
- "Cust_VBNAnhaenger_01_XIX_FASCANFD2LostCommError" to 'Detected'

*Testcase 32/39:
Set:
- "Ident_SensorID" := 'ECU1' | 'ECU9'
- "DiagCodingPlattformVW02" == '3: MEB'
- "EgoVehicle_IgnitionStatus" == 'IgnitionOn
- "Cust_ASW_Status" <> '1: Cx1_Aktiv'  longer than 2 seconds
- "Cust_CodingDataEcuForDrawBar" == '2: installed'
- Anhaenger_01_XIX_FASCANFD1 message is received for 1000 ms
Check:
- "Cust_VBNAnhaenger_01_XIX_FASCANFD2LostCommError" to 'NotDetected'

*Testcase 33/40:
Set:
- "Ident_SensorID" := 'ECU1' | 'ECU9'
- "DiagCodingPlattformVW02" == '3: MEB'
- "EgoVehicle_IgnitionStatus" == 'IgnitionOn
- "Cust_ASW_Status" <> '1: Cx1_Aktiv'  longer than 2 seconds
- "Cust_CodingDataEcuForDrawBar" <> '2: installed'
- Anhaenger_01_XIX_FASCANFD1 message is not received for 1000 ms
Check:
- "Cust_VBNAnhaenger_01_XIX_FASCANFD2LostCommError" to 'NotDetected'

*Testcase 34/41:
Set:
- "Ident_SensorID" := 'ECU1' | 'ECU9'
- "DiagCodingPlattformVW02" == '3: MEB'
- "EgoVehicle_IgnitionStatus" <> 'IgnitionOn
- "Cust_ASW_Status" == '1: Cx1_Aktiv'  shorter than 2 seconds
- "Cust_CodingDataEcuForDrawBar" == '2: installed'
- Anhaenger_01_XIX_FASCANFD1 message is not received for 1000 ms
Check:
- "Cust_VBNAnhaenger_01_XIX_FASCANFD2LostCommError" to 'NotDetected'

*Testcase 35/42:
Set:
- "Ident_SensorID" := 'ECU1' | 'ECU9'
- "DiagCodingPlattformVW02" == '3: MEB'
- "EgoVehicle_IgnitionStatus" <> 'IgnitionOn
- "Cust_ASW_Status" <> '1: Cx1_Aktiv'
- "Cust_CodingDataEcuForDrawBar" == '2: installed'
- Anhaenger_01_XIX_FASCANFD1 message is not received for 1000 ms
Check:
- "Cust_VBNAnhaenger_01_XIX_FASCANFD2LostCommError" to 'NotDetected'

//no need to executed this case because it is same with case 14 and case 28
*Testcase 36/43:
Set:
- "Ident_SensorID" := 'ECU1' | 'ECU9'
- "DiagCodingPlattformVW02" <> '3: MEB' ---> should be not coded
- "EgoVehicle_IgnitionStatus" == 'IgnitionOn
- "Cust_ASW_Status" <> '1: Cx1_Aktiv'  longer than 2 seconds
- "Cust_CodingDataEcuForDrawBar" == '2: installed'
- Anhaenger_01_XIX_FASCANFD1 message is not received for 1000 ms
Check:
- "Cust_VBNAnhaenger_01_XIX_FASCANFD2LostCommError" to 'NotDetected'

*Testcase 44:
Set:
- "Ident_SensorID" <> 'ECU1' | 'ECU9'
- "DiagCodingPlattformVW02" == '3: MEB'
- "EgoVehicle_IgnitionStatus" == 'IgnitionOn
- "Cust_ASW_Status" <> '1: Cx1_Aktiv'  longer than 2 seconds
- "Cust_CodingDataEcuForDrawBar" == '2: installed'
- Anhaenger_01_XIX_FASCANFD1 message is not received for 1000 ms
Check:
- "Cust_VBNAnhaenger_01_XIX_FASCANFD2LostCommError" to 'NotDetected'
*/


testcase SwT_VW_02_5485()	
{
	char chTemp[255]="";
	char coding_MEB[255]="";
	char coding_MQB[255]="";

	int current_ECU_Id = 0;
	const int NUMBER_OF_TESTCASE = 44;
	int i = 0;
	int Ident_SensorID[NUMBER_OF_TESTCASE]=									{0, 0, 0, 0, 0, 0, 0, 1, 1, 1, 1, 1, 1, 1, 8, 8, 8, 8, 8, 8, 8, 9, 9, 9, 9, 9, 9, 9, 2,//MQB
																			 1, 1, 1, 1, 1, 1, 1, 9, 9, 9, 9, 9, 9, 9, 0}; //MEB
	int DiagCodingPlattformVW02[NUMBER_OF_TESTCASE]=						{1, 1, 1, 1, 1, 1, 0, 1, 1, 1, 1, 1, 1, 0, 1, 1, 1, 1, 1, 1, 0, 1, 1, 1, 1, 1, 1, 0, 1,//MQB
																			 3, 3, 3, 3, 3, 3, 0, 3, 3, 3, 3, 3, 3, 0, 3}; //MEB
	int EgoVehicle_IgnitionStatus[NUMBER_OF_TESTCASE]=						{1, 0, 1, 1, 0, 0, 1, 1, 0, 1, 1, 0, 0, 1, 1, 0, 1, 1, 0, 0, 1, 1, 0, 1, 1, 0, 0, 1, 1,//MQB
																			 1, 0, 1, 1, 0, 0, 1, 1, 0, 1, 1, 0, 0, 1, 1}; //MEB																			
	int Cust_ASW_Status[NUMBER_OF_TESTCASE]=								{3, 1, 3, 3, 1, 3, 3, 3, 1, 3, 3, 1, 3, 3, 3, 1, 3, 3, 1, 3, 3, 3, 1, 3, 3, 1, 3, 3, 3,//MQB
																			 3, 1, 3, 3, 1, 3, 3, 3, 1, 3, 3, 1, 3, 3, 3};//MEB
	int flag_time_Cust_ASW_Status[NUMBER_OF_TESTCASE]=						{1, 1, 1, 1, 0, 1, 1, 1, 1, 1, 1, 0, 1, 1, 1, 1, 1, 1, 0, 1, 1, 1, 1, 1, 1, 0, 1, 1, 1,//MQB
																			 1, 1, 1, 1, 0, 1, 1, 1, 1, 1, 1, 0, 1, 1, 1};//MEB
	int Cust_CodingDataEcuForDrawBar[NUMBER_OF_TESTCASE]=					{2, 2, 2, 0, 2, 2, 2, 2, 2, 2, 0, 2, 2, 2, 2, 2, 2, 0, 2, 2, 2, 2, 2, 2, 0, 2, 2, 2, 2,//MQB
																			 2, 2, 2, 0, 2, 2, 2, 2, 2, 2, 0, 2, 2, 2, 2};//MEB
	int Anhaenger_01_XIX_FASCANFD2[NUMBER_OF_TESTCASE]=						{0, 0, 1, 0, 0, 0, 0, 0, 0, 1, 0, 0, 0, 0, 0, 0, 1, 0, 0, 0, 0, 0, 0, 1, 0, 0, 0, 0, 0,//MQB
																			 0, 0, 1, 0, 0, 0, 0, 0, 0, 1, 0, 0, 0, 0, 0};//MEB
	int Cust_VBNAnhaenger_01_XIX_FASCANFD2LostCommError[NUMBER_OF_TESTCASE]={2, 2, 1, 1, 1, 1, 1, 2, 2, 1, 1, 1, 1, 1, 2, 2, 1, 1, 1, 1, 1, 2, 2, 1, 1, 1, 1, 1, 1,//MQB
																			 2, 2, 1, 1, 1, 1, 1, 2, 2, 1, 1, 1, 1, 1, 1};//MEB
	
	//********************************************* Preconditions *********************************************
	funcIDE_DeleteAllBP();
	funcIDE_Reset();
	func_Wait(1000);
	funcIDE_Run();
	func_Wait(3000);
	current_ECU_Id = funcIDE_ReadVariable("Rte_SensorId_SensorId_SensorId");
	//********************************************* Preconditions *********************************************
	
	//********************************************* Test case title *********************************************
	snprintf(chTemp, 255, "X:\\30_Reports\\Customization\\SwT_VW_02_5485_ECU%d", current_ECU_Id);
	testReportFileName(chTemp);
	TestCaseTitle("SwT_VW_02_5485","Check that Cust_VBNAnhaenger_01_XIX_FASCANFD2LostCommError is set correctly following test design");
	//********************************************* Test case title *********************************************
		
	//********************************************* Test Cases ************************************************
	TestStepFail("message name in requirement is not correct. it should be Anhaenger_01_XIX_FASCANFD2 instead of Anhaenger_01_XIX_FASCANFD1");
	TestStepPass("This test script is run for message name FD2");
	
	switch(current_ECU_Id)
	{
		case 0:{
			snprintf(coding_MEB, 255, "995659154BC805000000");
			snprintf(coding_MQB, 255, "9956591549C805000000");
			break;
		}
		case 1:{
			snprintf(coding_MEB, 255, "9969A9164B480A000000");
			snprintf(coding_MQB, 255, "9969A91649480A000000");
			break;
		}
		case 8:{
			snprintf(coding_MEB, 255, "99565D152BC405000000");
			snprintf(coding_MQB, 255, "99565D1529C405000000");
			break;
		}
		case 9:{
			snprintf(coding_MEB, 255, "9969AD162B440A000000");
			snprintf(coding_MQB, 255, "9969AD1629440A000000");
			break;
		}
		case 2:
		case 3:
		{
			snprintf(coding_MEB, 255, "559556154BC805000000");
			snprintf(coding_MQB, 255, "5595561549C805000000");
			break;
		}		
		default:
			break;
	}
	for (i = 0; i < NUMBER_OF_TESTCASE; i++)
	{
		if(current_ECU_Id != Ident_SensorID[i])
		{
			/*cannot simulate sensor ID due to cannot control coding*/
			continue;
		}
		
		snprintf(chTemp, 1024, " ************************* Case %d ************************* ", i + 1);  
		func_TestStepSubSection(chTemp);
		if(i==35 || i== 42) //case 36 and case 43
		{
			TestStepPass("no need to executed this case because it is same with case 14 and case 28");
		}
		else
		{
			if(DiagCodingPlattformVW02[i] == 0) //case not_coded
			{
				funcIDE_WriteVariable("(Rte_Coding_Coding_Data).platform_en", DiagCodingPlattformVW02[i]);
				func_Wait(2000);
			}
			else
			{
				if(funcIDE_ReadVariable("(Rte_Coding_Coding_Data).platform_en") != DiagCodingPlattformVW02[i]) //(change coding by debugger)
				{
					//if current coding is meb -> switch to mqb
					if(funcIDE_ReadVariable("(Rte_Coding_Coding_Data).platform_en") == 3){
						Main_coding(coding_MQB);
					}
					//if current coding is mqb -> switch to meb
					else if(funcIDE_ReadVariable("(Rte_Coding_Coding_Data).platform_en") == 1){
						Main_coding(coding_MEB);
					}
					funcIDE_DeleteAllBP();
					funcIDE_Reset();
					func_Wait(1000);
					funcIDE_Run();
					func_Wait(3000);					
				}
			}
			@IL_CAN2::NODES::N_VectorSimulationNode::PDUS::Anhaenger_01_XIX_FASCANFD2::TIMINGS::FIEnableTXofPDU = Cust_VBNAnhaenger_01_XIX_FASCANFD2LostCommError[i];
			func_Wait(1000);
			funcWinIdea_SetBPSource("Vda_Ist_SetTimeoutErrors","(void)Rte_Read_Coding_Data_Data(&CodingData_st)"); 
			funcIDE_WaitForHalt(5000);
			funcIDE_ReadVariableandCheck("Rte_SensorId_SensorId_SensorId", Ident_SensorID[i], equal);
			funcIDE_ReadVariableandCheck("(Rte_Coding_Coding_Data).platform_en", DiagCodingPlattformVW02[i], equal);
			funcIDE_WriteVariable("Vda_Ist_VehicleData_st.IgnitionState_en", EgoVehicle_IgnitionStatus[i]);
			funcIDE_WriteVariable("Rte_Coding_Coding_Data.ecuForDrawBar_en", Cust_CodingDataEcuForDrawBar[i]);
			funcIDE_WriteVariable("ASW_state", Cust_ASW_Status[i]);
			
			if(flag_time_Cust_ASW_Status[i] == 0){
				funcIDE_WriteVariable("debounceCounterASWStatus_u16", 199);
			}
			else{
				funcIDE_WriteVariable("debounceCounterASWStatus_u16", 200);
			}
			funcWinIdea_SetBPSource("Vda_Ist_ProcessError_Main","(void)Rte_Read_Coding_Data_Data(&CodingData_st)"); 
			funcIDE_Run();
			funcIDE_WaitForHalt(5000);
			funcIDE_ReadVariableandCheck("EventMdw_ErrorResult_ast[EVHND_EVENT_VDA_ANHAENGER_01_FASCANFD2_LOST_COMM].testResultRaw_u8", Cust_VBNAnhaenger_01_XIX_FASCANFD2LostCommError[i], equal);
				
		}
		
		//Reset BP
		funcIDE_DeleteAllBP();
		funcIDE_Reset();
		func_Wait(1000);
		funcIDE_Run();
		func_Wait(3000);	
	}		
 }
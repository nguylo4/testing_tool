/*@!Encoding:1252*/
includes
{
  
}

variables
{

}
/*

@requirement/s
[PO_01_RS_93637]
IF	"Ident_SensorID" == 'ECU0' OR 'ECU8', THEN: the function "TLT Customizing Function" shall «set "TLT_Req_NR_03_CRC_XIX_TLT_Req_NR_03_XIX_FASCANFD2" := "Cust_TLTSlaveNRx_CRC"»       // Nanoradar NR_3

ELSE IF "Ident_SensorID"  == 'ECU1' OR 'ECU9', THEN: the function "TLT Customizing Function" shall «set "TLT_Req_NR_04_CRC_XIX_TLT_Req_NR_04_XIX_FASCANFD2" := "Cust_TLTSlaveNRx_CRC"»       // Nanoradar NR_4

ELSE IF "Ident_SensorID"  == 'ECU2', THEN: the function "TLT Customizing Function" shall «set "TLT_Req_NR_01_CRC_XIX_TLT_Req_NR_01_XIX_FASCANFD1" := "Cust_TLTSlaveNRx_CRC"»       // Nanoradar NR_1
 
ELSE IF "Ident_SensorID"  == 'ECU3', THEN: the function "TLT Customizing Function" shall «set "TLT_Req_NR_02_CRC_XIX_TLT_Req_NR_02_XIX_FASCANFD1" := "Cust_TLTSlaveNRx_CRC"».       // Nanoradar NR_2

//  else branch is not considered because it's equal to 'ECU0' - behaviour defined and realized by Feature "Sensor Identification (Ident)".
----------------------------------------------------------------------------------------------------------------------------------------------------------------
// @SW release : RC_CUST_DAS_VW_02_01_SW_T091.03.01
@date : 05 May 2023
@author : Hua Truong
@observations :
----------------------------------------------------------------------------------------------------------------------------------------------------------------
// @SW release : RC_CUST_DAS_VW_02_U151.01.01
@date : Jun 19 2024
@author : Nguyen Loc
@observations :
----------------------------------------------------------------------------------------------------------------------------------------------------------------
// @SW release : RC_CUST_DAS_VW_02_U154.01.01
@date : Sep 18 2024
@author : Nguyen Loc
@observations :
----------------------------------------------------------------------------------------------------------------------------------------------------------------
// @SW release : RC_CUST_DAS_VW_02_U190.01.01
@date : May 07 2025
@author : Hua Truong
@observations :
----------------------------------------------------------------------------------------------------------------------------------------------------------------

@Test case:
Check the function "TLT Customizing Function" shall set as requirement
min == 0
min+1 == 1
max == 255
max - 1 = 254
random value: 127


/-------------------------MQB coding----------------------------
*Case 1:
Set: 
- "DiagCodingPlattformVW02" == ['1: MQB37W']
- "Ident_SensorID"  := 'ECU0'
- "Cust_TLTSlaveNRx_CRC" := 0 
Check: 
- "TLT_Req_NR_03_CRC_XIX_TLT_Req_NR_03_XIX_FASCANFD2" := 0

*Case 2:
Set: 
- "DiagCodingPlattformVW02" == ['1: MQB37W']
- "Ident_SensorID"  := 'ECU0'
- "Cust_TLTSlaveNRx_CRC" := 1
Check: 
- "TLT_Req_NR_03_CRC_XIX_TLT_Req_NR_03_XIX_FASCANFD2" := 1

Case 3:
Set: 
- "DiagCodingPlattformVW02" == ['1: MQB37W']
- "Ident_SensorID"  := 'ECU0'
- "Cust_TLTSlaveNRx_CRC" := 255
Check: 
- "TLT_Req_NR_03_CRC_XIX_TLT_Req_NR_03_XIX_FASCANFD2" := 255

Case 4:
Set: 
- "DiagCodingPlattformVW02" == ['1: MQB37W']
- "Ident_SensorID"  := 'ECU0'
- "Cust_TLTSlaveNRx_CRC" := 254
Check: 
- "TLT_Req_NR_03_CRC_XIX_TLT_Req_NR_03_XIX_FASCANFD2" := 254

*Case 5:
Set: 
- "DiagCodingPlattformVW02" == ['1: MQB37W']
- "Ident_SensorID"  := 'ECU0'
- "Cust_TLTSlaveNRx_CRC" := 127
Check: 
- "TLT_Req_NR_03_CRC_XIX_TLT_Req_NR_03_XIX_FASCANFD2" := 127

*Case 6:
Set: 
- "DiagCodingPlattformVW02" == ['1: MQB37W']
- "Ident_SensorID"  := 'ECU1'
- "Cust_TLTSlaveNRx_CRC" := 0
Check: 
- "TLT_Req_NR_04_CRC_XIX_TLT_Req_NR_04_XIX_FASCANFD2" := 0

*Case 7:
Set: 
- "DiagCodingPlattformVW02" == ['1: MQB37W']
- "Ident_SensorID"  := 'ECU1'
- "Cust_TLTSlaveNRx_CRC" := 1
Check: 
- "TLT_Req_NR_04_CRC_XIX_TLT_Req_NR_04_XIX_FASCANFD2" := 1

Case 8:
Set: 
- "DiagCodingPlattformVW02" == ['1: MQB37W']
- "Ident_SensorID"  := 'ECU1'
- "Cust_TLTSlaveNRx_CRC" := 255
Check: 
- "TLT_Req_NR_04_CRC_XIX_TLT_Req_NR_04_XIX_FASCANFD2" := 255

Case 9:
Set: 
- "DiagCodingPlattformVW02" == ['1: MQB37W']
- "Ident_SensorID"  := 'ECU1'
- "Cust_TLTSlaveNRx_CRC" := 254
Check: 
- "TLT_Req_NR_04_CRC_XIX_TLT_Req_NR_04_XIX_FASCANFD2" := 254

*Case 10:
Set: 
- "DiagCodingPlattformVW02" == ['1: MQB37W']
- "Ident_SensorID"  := 'ECU1'
- "Cust_TLTSlaveNRx_CRC" := 127
Check: 
- "TLT_Req_NR_04_CRC_XIX_TLT_Req_NR_04_XIX_FASCANFD2" := 127

*Case 11:
Set: 
- "DiagCodingPlattformVW02" == ['1: MQB37W']
- "Ident_SensorID"  := 'ECU8'
- "Cust_TLTSlaveNRx_CRC" := 0
Check: 
- "TLT_Req_NR_03_CRC_XIX_TLT_Req_NR_03_XIX_FASCANFD2" := 0

*Case 12:
Set: 
- "DiagCodingPlattformVW02" == ['1: MQB37W']
- "Ident_SensorID"  := 'ECU8'
- "Cust_TLTSlaveNRx_CRC" := 1
Check: 
- "TLT_Req_NR_03_CRC_XIX_TLT_Req_NR_03_XIX_FASCANFD2" := 1

Case 13:
Set: 
- "DiagCodingPlattformVW02" == ['1: MQB37W']
- "Ident_SensorID"  := 'ECU8'
- "Cust_TLTSlaveNRx_CRC" := 255
Check: 
- "TLT_Req_NR_03_CRC_XIX_TLT_Req_NR_03_XIX_FASCANFD2" := 255

Case 14:
Set: 
- "DiagCodingPlattformVW02" == ['1: MQB37W']
- "Ident_SensorID"  := 'ECU8'
- "Cust_TLTSlaveNRx_CRC" := 254
Check: 
- "TLT_Req_NR_03_CRC_XIX_TLT_Req_NR_03_XIX_FASCANFD2" := 254

*Case 15:
Set: 
- "DiagCodingPlattformVW02" == ['1: MQB37W']
- "Ident_SensorID"  := 'ECU8'
- "Cust_TLTSlaveNRx_CRC" := 127
Check: 
- "TLT_Req_NR_03_CRC_XIX_TLT_Req_NR_03_XIX_FASCANFD2" := 127

*Case 16:
Set: 
- "DiagCodingPlattformVW02" == ['1: MQB37W']
- "Ident_SensorID"  := 'ECU9'
- "Cust_TLTSlaveNRx_CRC" := 0
Check: 
- "TLT_Req_NR_04_CRC_XIX_TLT_Req_NR_04_XIX_FASCANFD2" := 0

*Case 17:
Set: 
- "DiagCodingPlattformVW02" == ['1: MQB37W']
- "Ident_SensorID"  := 'ECU9'
- "Cust_TLTSlaveNRx_CRC" := 1
Check: 
- "TLT_Req_NR_04_CRC_XIX_TLT_Req_NR_04_XIX_FASCANFD2" := 1

Case 18:
Set: 
- "DiagCodingPlattformVW02" == ['1: MQB37W']
- "Ident_SensorID"  := 'ECU9'
- "Cust_TLTSlaveNRx_CRC" := 255
Check: 
- "TLT_Req_NR_04_CRC_XIX_TLT_Req_NR_04_XIX_FASCANFD2" := 255

Case 19:
Set: 
- "DiagCodingPlattformVW02" == ['1: MQB37W']
- "Ident_SensorID"  := 'ECU9'
- "Cust_TLTSlaveNRx_CRC" := 254
Check: 
- "TLT_Req_NR_04_CRC_XIX_TLT_Req_NR_04_XIX_FASCANFD2" := 254

*Case 20:
Set: 
- "DiagCodingPlattformVW02" == ['1: MQB37W']
- "Ident_SensorID"  := 'ECU9'
- "Cust_TLTSlaveNRx_CRC" := 127
Check: 
- "TLT_Req_NR_04_CRC_XIX_TLT_Req_NR_04_XIX_FASCANFD2" := 127

*Case 21:
Set: 
- "DiagCodingPlattformVW02" == ['1: MQB37W']
- "Ident_SensorID"  := 'ECU2'
- "Cust_TLTSlaveNRx_CRC" := 0
Check: 
- "TLT_Req_NR_01_CRC_XIX_TLT_Req_NR_01_XIX_FASCANFD1" := 0

*Case 22:
Set: 
- "DiagCodingPlattformVW02" == ['1: MQB37W']
- "Ident_SensorID"  := 'ECU2'
- "Cust_TLTSlaveNRx_CRC" := 1
Check: 
- "TLT_Req_NR_01_CRC_XIX_TLT_Req_NR_01_XIX_FASCANFD1" := 1

Case 23:
Set: 
- "DiagCodingPlattformVW02" == ['1: MQB37W']
- "Ident_SensorID"  := 'ECU2'
- "Cust_TLTSlaveNRx_CRC" := 255
Check: 
- "TLT_Req_NR_01_CRC_XIX_TLT_Req_NR_01_XIX_FASCANFD1" := 255

Case 24:
Set: 
- "DiagCodingPlattformVW02" == ['1: MQB37W']
- "Ident_SensorID"  := 'ECU2'
- "Cust_TLTSlaveNRx_CRC" := 254
Check: 
- "TLT_Req_NR_01_CRC_XIX_TLT_Req_NR_01_XIX_FASCANFD1" := 254

*Case 25:
Set: 
- "DiagCodingPlattformVW02" == ['1: MQB37W']
- "Ident_SensorID"  := 'ECU2'
- "Cust_TLTSlaveNRx_CRC" := 127
Check: 
- "TLT_Req_NR_01_CRC_XIX_TLT_Req_NR_01_XIX_FASCANFD1" := 127

*Case 26:
Set: 
- "DiagCodingPlattformVW02" == ['1: MQB37W']
- "Ident_SensorID"  := 'ECU3'
- "Cust_TLTSlaveNRx_CRC" := 0
Check: 
- "TLT_Req_NR_02_CRC_XIX_TLT_Req_NR_02_XIX_FASCANFD1" := 0

*Case 27:
Set: 
- "DiagCodingPlattformVW02" == ['1: MQB37W']
- "Ident_SensorID"  := 'ECU3'
- "Cust_TLTSlaveNRx_CRC" := 1
Check: 
- "TLT_Req_NR_02_CRC_XIX_TLT_Req_NR_02_XIX_FASCANFD1" := 1

Case 28:
Set: 
- "DiagCodingPlattformVW02" == ['1: MQB37W']
- "Ident_SensorID"  := 'ECU3'
- "Cust_TLTSlaveNRx_CRC" := 255
Check: 
- "TLT_Req_NR_02_CRC_XIX_TLT_Req_NR_02_XIX_FASCANFD1" := 255

Case 29:
Set: 
- "DiagCodingPlattformVW02" == ['1: MQB37W']
- "Ident_SensorID"  := 'ECU3'
- "Cust_TLTSlaveNRx_CRC" := 254
Check: 
- "TLT_Req_NR_02_CRC_XIX_TLT_Req_NR_02_XIX_FASCANFD1" := 254

*Case 30:
Set: 
- "DiagCodingPlattformVW02" == ['1: MQB37W']
- "Ident_SensorID"  := 'ECU3'
- "Cust_TLTSlaveNRx_CRC" := 127
Check: 
- "TLT_Req_NR_02_CRC_XIX_TLT_Req_NR_02_XIX_FASCANFD1" := 127

/------------------------- MEB coding --------------------------------
*Case 31:
Set: 
- "DiagCodingPlattformVW02" == ['3: MEB']
- "Ident_SensorID"  := 'ECU0'
- "Cust_TLTSlaveNRx_CRC" := 0
Check: 
- "TLT_Req_NR_03_CRC_XIX_TLT_Req_NR_03_XIX_FASCANFD2" := 0

*Case 32:
Set: 
- "DiagCodingPlattformVW02" == ['3: MEB']
- "Ident_SensorID"  := 'ECU0'
- "Cust_TLTSlaveNRx_CRC" := 1
Check: 
- "TLT_Req_NR_03_CRC_XIX_TLT_Req_NR_03_XIX_FASCANFD2" := 1

Case 33:
Set: 
- "DiagCodingPlattformVW02" == ['3: MEB']
- "Ident_SensorID"  := 'ECU0'
- "Cust_TLTSlaveNRx_CRC" := 255
Check: 
- "TLT_Req_NR_03_CRC_XIX_TLT_Req_NR_03_XIX_FASCANFD2" := 255

Case 34:
Set: 
- "DiagCodingPlattformVW02" == ['3: MEB']
- "Ident_SensorID"  := 'ECU0'
- "Cust_TLTSlaveNRx_CRC" := 254
Check: 
- "TLT_Req_NR_03_CRC_XIX_TLT_Req_NR_03_XIX_FASCANFD2" := 254

*Case 35:
Set: 
- "DiagCodingPlattformVW02" == ['3: MEB']
- "Ident_SensorID"  := 'ECU0'
- "Cust_TLTSlaveNRx_CRC" := 127
Check: 
- "TLT_Req_NR_03_CRC_XIX_TLT_Req_NR_03_XIX_FASCANFD2" := 127

*Case 36:
Set: 
- "DiagCodingPlattformVW02" == ['3: MEB']
- "Ident_SensorID"  := 'ECU1'
- "Cust_TLTSlaveNRx_CRC" := 0
Check: 
- "TLT_Req_NR_04_CRC_XIX_TLT_Req_NR_04_XIX_FASCANFD2" := 0

*Case 37:
Set: 
- "DiagCodingPlattformVW02" == ['3: MEB']
- "Ident_SensorID"  := 'ECU1'
- "Cust_TLTSlaveNRx_CRC" := 1
Check: 
- "TLT_Req_NR_04_CRC_XIX_TLT_Req_NR_04_XIX_FASCANFD2" := 1

Case 38:
Set: 
- "DiagCodingPlattformVW02" == ['3: MEB']
- "Ident_SensorID"  := 'ECU1'
- "Cust_TLTSlaveNRx_CRC" := 255
Check: 
- "TLT_Req_NR_04_CRC_XIX_TLT_Req_NR_04_XIX_FASCANFD2" := 255

Case 39:
Set: 
- "DiagCodingPlattformVW02" == ['3: MEB']
- "Ident_SensorID"  := 'ECU1'
- "Cust_TLTSlaveNRx_CRC" := 254
Check: 
- "TLT_Req_NR_04_CRC_XIX_TLT_Req_NR_04_XIX_FASCANFD2" := 254

*Case 40:
Set: 
- "DiagCodingPlattformVW02" == ['3: MEB']
- "Ident_SensorID"  := 'ECU1'
- "Cust_TLTSlaveNRx_CRC" := 127
Check: 
- "TLT_Req_NR_04_CRC_XIX_TLT_Req_NR_04_XIX_FASCANFD2" := 127

*Case 41:
Set: 
- "DiagCodingPlattformVW02" == ['3: MEB']
- "Ident_SensorID"  := 'ECU8'
- "Cust_TLTSlaveNRx_CRC" := 0
Check: 
- "TLT_Req_NR_03_CRC_XIX_TLT_Req_NR_03_XIX_FASCANFD2" := 0

*Case 42:
Set: 
- "DiagCodingPlattformVW02" == ['3: MEB']
- "Ident_SensorID"  := 'ECU8'
- "Cust_TLTSlaveNRx_CRC" := 1
Check: 
- "TLT_Req_NR_03_CRC_XIX_TLT_Req_NR_03_XIX_FASCANFD2" := 1

Case 43:
Set: 
- "DiagCodingPlattformVW02" == ['3: MEB']
- "Ident_SensorID"  := 'ECU8'
- "Cust_TLTSlaveNRx_CRC" := 255
Check: 
- "TLT_Req_NR_03_CRC_XIX_TLT_Req_NR_03_XIX_FASCANFD2" := 255

Case 44:
Set: 
- "DiagCodingPlattformVW02" == ['3: MEB']
- "Ident_SensorID"  := 'ECU8'
- "Cust_TLTSlaveNRx_CRC" := 254
Check: 
- "TLT_Req_NR_03_CRC_XIX_TLT_Req_NR_03_XIX_FASCANFD2" := 254

*Case 45:
Set: 
- "DiagCodingPlattformVW02" == ['3: MEB']
- "Ident_SensorID"  := 'ECU8'
- "Cust_TLTSlaveNRx_CRC" := 127
Check: 
- "TLT_Req_NR_03_CRC_XIX_TLT_Req_NR_03_XIX_FASCANFD2" := 127

*Case 46:
Set: 
- "DiagCodingPlattformVW02" == ['3: MEB']
- "Ident_SensorID"  := 'ECU9'
- "Cust_TLTSlaveNRx_CRC" := 0
Check: 
- "TLT_Req_NR_04_CRC_XIX_TLT_Req_NR_04_XIX_FASCANFD2" := 0

*Case 47:
Set: 
- "DiagCodingPlattformVW02" == ['3: MEB']
- "Ident_SensorID"  := 'ECU9'
- "Cust_TLTSlaveNRx_CRC" := 1
Check: 
- "TLT_Req_NR_04_CRC_XIX_TLT_Req_NR_04_XIX_FASCANFD2" := 1

Case 48:
Set: 
- "DiagCodingPlattformVW02" == ['3: MEB']
- "Ident_SensorID"  := 'ECU9'
- "Cust_TLTSlaveNRx_CRC" := 255
Check: 
- "TLT_Req_NR_04_CRC_XIX_TLT_Req_NR_04_XIX_FASCANFD2" := 255

Case 49:
Set: 
- "DiagCodingPlattformVW02" == ['3: MEB']
- "Ident_SensorID"  := 'ECU9'
- "Cust_TLTSlaveNRx_CRC" := 254
Check: 
- "TLT_Req_NR_04_CRC_XIX_TLT_Req_NR_04_XIX_FASCANFD2" := 254

*Case 50:
Set: 
- "DiagCodingPlattformVW02" == ['3: MEB']
- "Ident_SensorID"  := 'ECU9'
- "Cust_TLTSlaveNRx_CRC" := 127
Check: 
- "TLT_Req_NR_04_CRC_XIX_TLT_Req_NR_04_XIX_FASCANFD2" := 127

*Case 51:
Set: 
- "DiagCodingPlattformVW02" == ['3: MEB']
- "Ident_SensorID"  := 'ECU2'
- "Cust_TLTSlaveNRx_CRC" := 0
Check: 
- "TLT_Req_NR_01_CRC_XIX_TLT_Req_NR_01_XIX_FASCANFD1" := 0

*Case 52:
Set: 
- "DiagCodingPlattformVW02" == ['3: MEB']
- "Ident_SensorID"  := 'ECU2'
- "Cust_TLTSlaveNRx_CRC" := 1
Check: 
- "TLT_Req_NR_01_CRC_XIX_TLT_Req_NR_01_XIX_FASCANFD1" := 1

Case 53:
Set: 
- "DiagCodingPlattformVW02" == ['3: MEB']
- "Ident_SensorID"  := 'ECU2'
- "Cust_TLTSlaveNRx_CRC" := 255
Check: 
- "TLT_Req_NR_01_CRC_XIX_TLT_Req_NR_01_XIX_FASCANFD1" := 255

Case 54:
Set: 
- "DiagCodingPlattformVW02" == ['3: MEB']
- "Ident_SensorID"  := 'ECU2'
- "Cust_TLTSlaveNRx_CRC" := 254
Check: 
- "TLT_Req_NR_01_CRC_XIX_TLT_Req_NR_01_XIX_FASCANFD1" := 254

*Case 55:
Set: 
- "DiagCodingPlattformVW02" == ['3: MEB']
- "Ident_SensorID"  := 'ECU2'
- "Cust_TLTSlaveNRx_CRC" := 127
Check: 
- "TLT_Req_NR_01_CRC_XIX_TLT_Req_NR_01_XIX_FASCANFD1" := 127

*Case 56:
Set: 
- "DiagCodingPlattformVW02" == ['3: MEB']
- "Ident_SensorID"  := 'ECU3'
- "Cust_TLTSlaveNRx_CRC" := 0
Check: 
- "TLT_Req_NR_02_CRC_XIX_TLT_Req_NR_02_XIX_FASCANFD1" := 0

*Case 57:
Set: 
- "DiagCodingPlattformVW02" == ['3: MEB']
- "Ident_SensorID"  := 'ECU3'
- "Cust_TLTSlaveNRx_CRC" := 1
Check: 
- "TLT_Req_NR_02_CRC_XIX_TLT_Req_NR_02_XIX_FASCANFD1" := 1

Case 58:
Set: 
- "DiagCodingPlattformVW02" == ['3: MEB']
- "Ident_SensorID"  := 'ECU3'
- "Cust_TLTSlaveNRx_CRC" := 255
Check: 
- "TLT_Req_NR_02_CRC_XIX_TLT_Req_NR_02_XIX_FASCANFD1" := 255

Case 59:
Set: 
- "DiagCodingPlattformVW02" == ['3: MEB']
- "Ident_SensorID"  := 'ECU3'
- "Cust_TLTSlaveNRx_CRC" := 254
Check: 
- "TLT_Req_NR_02_CRC_XIX_TLT_Req_NR_02_XIX_FASCANFD1" := 254

*Case 60:
Set: 
- "DiagCodingPlattformVW02" == ['3: MEB']
- "Ident_SensorID"  := 'ECU3'
- "Cust_TLTSlaveNRx_CRC" := 127
Check: 
- "TLT_Req_NR_02_CRC_XIX_TLT_Req_NR_02_XIX_FASCANFD1" := 127

//Negative case
*Case 61:
Set: 
- "DiagCodingPlattformVW02" ==['1: MQB37W']
- "Ident_SensorID"  := 'ECU4'
Check:
Not expected to check
// Negative case for ECU  <>  ECU0,  ECU1,  ECU2,  ECU3,  ECU8,  ECU9. Other sensor (ex. ECU4) is not applicable for SW configuration and RBS file is unavaible for testing

*Case 62:
Set: 
- "DiagCodingPlattformVW02" ==['3: MEB']
- "Ident_SensorID"  := 'ECU4'
Check:
Not expected to check
// Negative case for ECU  <>  ECU0,  ECU1,  ECU2,  ECU3,  ECU8,  ECU9. Other sensor (ex. ECU4) is not applicable for SW configuration and RBS file is unavaible for testing
*/

testcase SwT_VW_02_7287()
{
	int optcheck;
	int sensorID;
	int NR,j,SensorID,i,k;
	int checkvalue[5]={0,1,255,254,127};
	char BP[255], BPLine[255], Variable[255], sig[255],reportname[255], chtemp[255];
	//********************************************* Preconditions *********************************************
	
	funcIDE_DeleteAllBP();
	funcIDE_Reset();
	funcIDE_Run();
	func_Wait(2000);
	sensorID=funcIDE_ReadVariable("Rte_SensorId_SensorId_SensorId");
	snprintf(reportname,255,"X:\\30_Reports\\Customization\\SwT_VW_02_7287_ECU%d",sensorID);
	testReportFileName(reportname);
	TestCaseTitle("SwT_VW_02_7287","Check the function TLT Customizing Function perform as require");
  	sensorID=funcIDE_ReadVariable("Rte_SensorId_SensorId_SensorId");
  	func_Wait(200);
	//********************************************* End-conditions *********************************************
	
	k=0;
	funcIDE_WriteVariable("Rte_Coding_Coding_Data.platform_en",1); // MQB coding
	func_Wait(300);
  	sensorID=funcIDE_ReadVariable("Rte_SensorId_SensorId_SensorId");
  	switch(sensorID) //adapt to each sensorID
		{
			case 0:
			{
				i=0;
				NR=3;
				snprintf(BP, 255, "E2EPW_Write_VCOM_SG_TLT_Req_NR_0%d_VCOM_SG_TLT_Req_NR_0%d", NR, NR );
				snprintf(BPLine, 255, "AppData->TLT_Req_NR_0%d_CRC = ppa_VCOM_SG_TLT_Req_NR_0%d_VCOM_SG_TLT_Req_NR_", NR, NR );
				snprintf(Variable, 255, "(ppa_VCOM_SG_TLT_Req_NR_0%d_VCOM_SG_TLT_Req_NR_0%d_au8)[0]", NR, NR );
				snprintf(sig, 255, "TLT_Req_NR_0%d_CRC_XIX_TLT_Req_NR_0%d_XIX_FASCANFD2", NR, NR );
				break;
			}
			case 1:
			{
				i=5;
				NR=4;
				snprintf(BP, 255, "E2EPW_Write_VCOM_SG_TLT_Req_NR_0%d_VCOM_SG_TLT_Req_NR_0%d", NR, NR );
				snprintf(BPLine, 255, "AppData->TLT_Req_NR_0%d_CRC = ppa_VCOM_SG_TLT_Req_NR_0%d_VCOM_SG_TLT_Req_NR_", NR, NR );
				snprintf(Variable, 255, "(ppa_VCOM_SG_TLT_Req_NR_0%d_VCOM_SG_TLT_Req_NR_0%d_au8)[0]", NR, NR );
				snprintf(sig, 255, "TLT_Req_NR_0%d_CRC_XIX_TLT_Req_NR_0%d_XIX_FASCANFD2", NR, NR );
				break;
			}
			case 2:
			{
				i=20;
				NR=1;
				snprintf(BP, 255, "E2EPW_Write_VCOM_SG_TLT_Req_NR_0%d_VCOM_SG_TLT_Req_NR_0%d", NR, NR );
				snprintf(BPLine, 255, "AppData->TLT_Req_NR_0%d_CRC = ppa_VCOM_SG_TLT_Req_NR_0%d_VCOM_SG_TLT_Req_NR_", NR, NR );
				snprintf(Variable, 255, "(ppa_VCOM_SG_TLT_Req_NR_0%d_VCOM_SG_TLT_Req_NR_0%d_au8)[0]", NR, NR );
				snprintf(sig, 255, "TLT_Req_NR_0%d_CRC_XIX_TLT_Req_NR_0%d_XIX_FASCANFD1", NR, NR );
				break;
			}
			case 3:
			{
				i=25;
				NR=2;
				snprintf(BP, 255, "E2EPW_Write_VCOM_SG_TLT_Req_NR_0%d_VCOM_SG_TLT_Req_NR_0%d", NR, NR );
				snprintf(BPLine, 255, "AppData->TLT_Req_NR_0%d_CRC = ppa_VCOM_SG_TLT_Req_NR_0%d_VCOM_SG_TLT_Req_NR_", NR, NR );
				snprintf(Variable, 255, "(ppa_VCOM_SG_TLT_Req_NR_0%d_VCOM_SG_TLT_Req_NR_0%d_au8)[0]", NR, NR );
				snprintf(sig, 255, "TLT_Req_NR_0%d_CRC_XIX_TLT_Req_NR_0%d_XIX_FASCANFD1", NR, NR );
				break;
			}
			case 8:
			{
				i=10;
				NR=3;
				snprintf(BP, 255, "E2EPW_Write_VCOM_SG_TLT_Req_NR_0%d_VCOM_SG_TLT_Req_NR_0%d", NR, NR );
				snprintf(BPLine, 255, "AppData->TLT_Req_NR_0%d_CRC = ppa_VCOM_SG_TLT_Req_NR_0%d_VCOM_SG_TLT_Req_NR_", NR, NR );
				snprintf(Variable, 255, "(ppa_VCOM_SG_TLT_Req_NR_0%d_VCOM_SG_TLT_Req_NR_0%d_au8)[0]", NR, NR );
				snprintf(sig, 255, "TLT_Req_NR_0%d_CRC_XIX_TLT_Req_NR_0%d_XIX_FASCANFD2", NR, NR );
				break;
			}
			case 9:
			{
				i=15;
				NR=4;
				snprintf(BP, 255, "E2EPW_Write_VCOM_SG_TLT_Req_NR_0%d_VCOM_SG_TLT_Req_NR_0%d", NR, NR );
				snprintf(BPLine, 255, "AppData->TLT_Req_NR_0%d_CRC = ppa_VCOM_SG_TLT_Req_NR_0%d_VCOM_SG_TLT_Req_NR_", NR, NR );
				snprintf(Variable, 255, "(ppa_VCOM_SG_TLT_Req_NR_0%d_VCOM_SG_TLT_Req_NR_0%d_au8)[0]", NR, NR );
				snprintf(sig, 255, "TLT_Req_NR_0%d_CRC_XIX_TLT_Req_NR_0%d_XIX_FASCANFD2", NR, NR );
				break;
			}
      		default:
        	break;
		}

	
	for ( j = i; j < i+5; j++) // check 5 times for each ECU
	{
    	sensorID=funcIDE_ReadVariable("Rte_SensorId_SensorId_SensorId");
		testStep("+++" , "+++ SECTION: ------------------------------------CASE %d  ------------------------------------", j+1);
    	funcIDE_WriteVariable("Rte_Coding_Coding_Data.platform_en",1); // MQB coding
	
		//funcWinIdea_SetBPSource("E2EPW_Write_VCOM_SG_TLT_Req_NR_01_VCOM_SG_TLT_Req_NR_01","AppData->TLT_Req_NR_01_CRC = ppa_VCOM_SG_TLT_Req_NR_01_VCOM_SG_TLT_Req_NR_01_au8[offset_u16 + 0];");
		// funcIDE_SetBPLine(188,"Y:/Source/Autosar/Variant_DAS_VW_02/Integration/E2E/E2EPW_Vda_VCOM_SG_TLT_Req_NR_01_VCOM_SG_TLT_Req_NR_01_tx.c");
		funcWinIdea_SetBPSource(BP,BPLine);
		funcIDE_WaitForHalt(3000);					
		funcIDE_WriteVariable(Variable,checkvalue[k]);
		func_wait(1000);  
		
		funcWinIdea_SetBPSource("Tlt_Main","if (TLT_INITIALIZATION_PATTERN_U32 != Tst_Init_u32)");
		// funcIDE_SetBPLine(240,"Y:/Source/TrustworthyLocalTime/Variant_DAS_VW_02/Tlt_Main.c");
		funcIDE_Run();
		funcIDE_WaitForHalt(3000);
		// Check value of "TLT_Req_NR_01_CRC_XIX_TLT_Req_NR_01_XIX_FASCANFD1"
		optcheck = getSignal(sig);
		if (optcheck==checkvalue[k])
		{
			snprintf(chtemp,255,"Pass check: signal have value %d ",optcheck);
			teststeppass(chtemp);
		}
		else
		{
			snprintf(chtemp,255,"Fail check: signal have value %d ",optcheck);
			teststepfail(chtemp);
		}
	
		k++;
	
		funcIDE_DeleteAllBP();
		funcIDE_Reset();
		funcIDE_Run();
		func_Wait(3000);
	}

	k=0;
	
	func_Wait(300);
	for ( j = i+30; j < i+30+5; j++) // check 5 times for each ECU
	{
		testStep("+++" , "+++ SECTION: ------------------------------------CASE %d ------------------------------------", j+1);
    	funcIDE_WriteVariable("Rte_Coding_Coding_Data.platform_en",3); // MEB coding
      
  		funcWinIdea_SetBPSource(BP,BPLine);
  		funcIDE_WaitForHalt(3000);					
  		funcIDE_WriteVariable(Variable,checkvalue[k]);
  		func_wait(1000);  
  		
  		funcWinIdea_SetBPSource("Tlt_Main","if (TLT_INITIALIZATION_PATTERN_U32 != Tst_Init_u32)");
  		// funcIDE_SetBPLine(240,"Y:/Source/TrustworthyLocalTime/Variant_DAS_VW_02/Tlt_Main.c");
  		funcIDE_Run();
  		funcIDE_WaitForHalt(3000);

		optcheck = getSignal(sig);
		if (optcheck == checkvalue[k])
		{
			snprintf(chtemp,255,"Pass check: signal have value %d ",optcheck);
			teststeppass(chtemp);
		}
		else
		{
			snprintf(chtemp,255,"Fail check: signal have value %d ",optcheck);
			teststepfail(chtemp);
		}
		
		k++;
	
		funcIDE_DeleteAllBP();
		funcIDE_Reset();
		funcIDE_Run();
		func_Wait(3000);
	}


	// RESET ENVIRONMENT 
	funcIDE_DeleteAllBP();
	funcIDE_Reset();
	func_Wait(2000);
	funcIDE_Run();
	func_Wait(2000);
 }
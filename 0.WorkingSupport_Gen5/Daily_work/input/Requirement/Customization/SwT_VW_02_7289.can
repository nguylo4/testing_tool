/*@!Encoding:1252*/
includes
{
  
}

variables
{

}
/*

@requirement/s
[PO_01_RS_92924]
IF	"Ident_SensorID" == 'ECU0' OR 'ECU8', THEN: the function "TLT Normalization" shall «set "Cust_TLTMaster_BZ" := "TLT_Resp_NR_03_BZ_XIX_TLT_Resp_NR_03_XIX_FASCANFD2"»       // Nanoradar NR_3

ELSE IF "Ident_SensorID"  == 'ECU1 OR 'ECU9', THEN: the function "TLT Normalization" shall «set "Cust_TLTMaster_BZ" := "TLT_Resp_NR_04_BZ_XIX_TLT_Resp_NR_04_XIX_FASCANFD2"»       // Nanoradar NR_4

ELSE IF "Ident_SensorID"  == 'ECU2', THEN: the function "TLT Normalization" shall «set "Cust_TLTMaster_BZ" := "TLT_Resp_NR_01_BZ_XIX_TLT_Resp_NR_01_XIX_FASCANFD1"»       // Nanoradar NR_1

ELSE IF "Ident_SensorID"  == 'ECU3', THEN: the function "TLT Normalization" shall «set "Cust_TLTMaster_BZ" := "TLT_Resp_NR_02_BZ_XIX_TLT_Resp_NR_02_XIX_FASCANFD1"».       // Nanoradar NR_2

//  else branch is not considered because it's equal to 'ECU0' - behaviour defined and realized by Feature "Sensor Identification (Ident)".
----------------------------------------------------------------------------------------------------------------------------------------------------------------
// @SW release : RC_CUST_DAS_VW_02_U151.01.01
@date : Jun 19 2024
@author : Nguyen Loc
@observations :
----------------------------------------------------------------------------------------------------------------------------------------------------------------
// @SW release : RC_CUST_DAS_VW_02_U154.01.01
@date : September 18 2024
@author : Ly Nhi
@observations :
----------------------------------------------------------------------------------------------------------------------------------------------------------------
// @SW release : RC_CUST_DAS_VW_02_U172.01.01
@date : Jan 13 2025
@author : Nguyen Loc
@observations :
----------------------------------------------------------------------------------------------------------------------------------------------------------------
// @SW release : RC_CUST_DAS_VW_02_U190.01.01
@date : May 07 2025
@author : Hua Truong
@observations :
----------------------------------------------------------------------------------------------------------------------------------------------------------------

@Test case:
Check the function "TLT Normalization" shall set as requirement

*Case 1:
Set: 
	- "Ident_SensorID"  := 'ECU0'
	- "DiagCodingPlattformVW02" == ['1: MQB37W']

Check: 
	- "Cust_TLTMaster_BZ" := TLT_Resp_NR_03_BZ_XIX_TLT_Resp_NR_03_XIX_FASCANFD2

*Case 2:
Set: 
	- "Ident_SensorID"  := 'ECU1'
	- "DiagCodingPlattformVW02" == ['1: MQB37W']

Check: 
	- "Cust_TLTMaster_BZ" := TLT_Resp_NR_04_BZ_XIX_TLT_Resp_NR_04_XIX_FASCANFD2


*Case 3:
Set: 
	- "Ident_SensorID"  := 'ECU2'
	- "DiagCodingPlattformVW02" == ['1: MQB37W']

Check: 
	- "Cust_TLTMaster_BZ" := TLT_Resp_NR_01_BZ_XIX_TLT_Resp_NR_01_XIX_FASCANFD1

*Case 4:
Set: 
	- "Ident_SensorID"  := 'ECU3'
	- "DiagCodingPlattformVW02" == ['1: MQB37W']

Check: 
	- "Cust_TLTMaster_BZ" := TLT_Resp_NR_02_BZ_XIX_TLT_Resp_NR_02_XIX_FASCANFD1

*Case 5:
Set: 
	- "Ident_SensorID"  := 'ECU8'
	- "DiagCodingPlattformVW02" == ['1: MQB37W']

Check: 
	- "Cust_TLTMaster_BZ" := TLT_Resp_NR_03_BZ_XIX_TLT_Resp_NR_03_XIX_FASCANFD2

*Case 6:
Set: 
	- "Ident_SensorID"  := 'ECU9'
	- "DiagCodingPlattformVW02" == ['1: MQB37W']

Check: 
	- "Cust_TLTMaster_BZ" := TLT_Resp_NR_04_BZ_XIX_TLT_Resp_NR_04_XIX_FASCANFD2

*Case 7:
Set: 
	- "Ident_SensorID"  := 'ECU0'
	- "DiagCodingPlattformVW02" == ['3: MEB']

Check: 
	- "Cust_TLTMaster_BZ" := TLT_Resp_NR_03_BZ_XIX_TLT_Resp_NR_03_XIX_FASCANFD2

*Case 8:
Set: 
	- "Ident_SensorID"  := 'ECU1'
	- "DiagCodingPlattformVW02" == ['3: MEB']


Check: 
	- "Cust_TLTMaster_BZ" := TLT_Resp_NR_04_BZ_XIX_TLT_Resp_NR_04_XIX_FASCANFD2


*Case 9:
Set: 
	- "Ident_SensorID"  := 'ECU2'
	- "DiagCodingPlattformVW02" == ['3: MEB']

Check: 
	- "Cust_TLTMaster_BZ" := TLT_Resp_NR_01_BZ_XIX_TLT_Resp_NR_01_XIX_FASCANFD1

*Case 10:
Set: 
	- "Ident_SensorID"  := 'ECU3'
	- "DiagCodingPlattformVW02" == ['3: MEB']

Check: 
	- "Cust_TLTMaster_BZ" := TLT_Resp_NR_02_BZ_XIX_TLT_Resp_NR_02_XIX_FASCANFD1

*Case 11:
Set: 
	- "Ident_SensorID"  := 'ECU8'
	- "DiagCodingPlattformVW02" == ['3: MEB']

Check: 
	- "Cust_TLTMaster_BZ" := TLT_Resp_NR_03_BZ_XIX_TLT_Resp_NR_03_XIX_FASCANFD2

*Case 12:
Set: 
	- "Ident_SensorID"  := 'ECU9'
	- "DiagCodingPlattformVW02" == ['3: MEB']

Check: 
	- "Cust_TLTMaster_BZ" := TLT_Resp_NR_04_BZ_XIX_TLT_Resp_NR_04_XIX_FASCANFD2

#Negative Test
*Case 13:
Set: 
	- "Ident_SensorID"  <> 'ECU0'
	- "Ident_SensorID"  <> 'ECU1'
	- "Ident_SensorID"  <> 'ECU2'
	- "Ident_SensorID"  <> 'ECU3'
	- "Ident_SensorID"  <> 'ECU8'
	- "Ident_SensorID"  <> 'ECU9'

Check: 
	Not expected to check
	// Negative case for ECU  <>  ECU0,  ECU1,  ECU2,  ECU3,  ECU8,  ECU9. Other sensor (ex. ECU4) is not applicable for SW configuration and RBS file is unavaible for testing



*/

testcase SwT_VW_02_7289()
{
	const NUMBER_OF_TESTCASE = 8;
	int TLTMaster_BZ;
	int bz;
	int SensorID;
	int i,j;
	const int CODING_PLATFORM_MQB37W = 1;
	const int CODING_PLATFORM_MEB = 3;
	char reportname[255],signalname[255];
    TestCaseTitle("SwT_VW_02_7289", "To check Cust_TLTMaster_BZ in function TLT Normalization shall set as TLT_Resp_NR_0X_BZ_XIX_TLT_Resp_NR_0X_XIX_FASCANFDY");

/***********************************************************************************************************************************************
 * PRECONDS
 ***********************************************************************************************************************************************/

    func_testStepSubSection("Reset the environment");
    funcIDE_DeleteAllBP();
    funcIDE_Reset();
	func_Wait(1000);
	funcIDE_Run();
    func_Wait(3000);

/***********************************************************************************************************************************************
 * TEST CASE
 ***********************************************************************************************************************************************/

	i=10; //init value
	SensorID=funcIDE_ReadVariable("Rte_SensorId_SensorId_SensorId");
	switch(SensorID) //adapt to each sensorID
	{
		case 0:
		{
			i=0;
			snprintf(signalname,255,"TLT_Resp_NR_03_BZ_XIX_TLT_Resp_NR_03_XIX_FASCANFD2");
			break;
		}
		case 1:
		{
			i=1;
			snprintf(signalname,255,"TLT_Resp_NR_04_BZ_XIX_TLT_Resp_NR_04_XIX_FASCANFD2");
			break;
		}
		case 2:
		{
			i=2;
			snprintf(signalname,255,"TLT_Resp_NR_01_BZ_XIX_TLT_Resp_NR_01_XIX_FASCANFD1");
			break;
		}
		case 3:
		{
			i=3;
			snprintf(signalname,255,"TLT_Resp_NR_02_BZ_XIX_TLT_Resp_NR_02_XIX_FASCANFD1");
			break;
		}
		case 8:
		{
			i=4;
			snprintf(signalname,255,"TLT_Resp_NR_03_BZ_XIX_TLT_Resp_NR_03_XIX_FASCANFD2");
			break;
		}
		case 9:
		{
			i=5;
			snprintf(signalname,255,"TLT_Resp_NR_04_BZ_XIX_TLT_Resp_NR_04_XIX_FASCANFD2");
			break;
		}
	}
	
	snprintf(reportname,255,"X:\\30_Reports\\Customization\\SwT_VW_02_7289_ECU%d",SensorID);
	testReportFileName(reportname);

	testStep("+++" , "+++ SECTION: ------------------------------------CASE %d for ECU_%d ------------------------------------", i+1,SensorID);
		
	for ( j = 0; j<5; j++) // repeat check 5 times to make sure
	{		
		funcIDE_WriteVariable("Rte_Coding_Coding_Data.platform_en",1); // MQB coding
		funcIDE_ReadVariableAndCheck("Rte_SensorId_SensorId_SensorId",SensorID,equal);
		func_Wait(300);
		funcWinIdea_SetBPSource("Tlt_RxIndication","messageState_st.followupState = TRUE");
		funcIDE_WaitForHalt(3000); 
		
		TLTMaster_BZ = getSignal(signalname);
		funcIDE_ReadVariableAndCheck("(msgIn_st).TLT_BZ", TLTMaster_BZ); 	
		
		funcIDE_DeleteAllBP();
		funcIDE_Reset();
		func_Wait(1000);
		funcIDE_Run();
		func_Wait(3000);
	}

	testStep("+++" , "+++ SECTION: ------------------------------------CASE %d for ECU_%d ------------------------------------", i+7,SensorID);
		
	for ( j = 0; j<5; j++) // repeat check 5 times to make sure
	{	
		funcIDE_WriteVariable("Rte_Coding_Coding_Data.platform_en",3); // MEB coding
		funcIDE_ReadVariableAndCheck("Rte_SensorId_SensorId_SensorId",SensorID,equal);
		func_Wait(300);
		funcWinIdea_SetBPSource("Tlt_RxIndication","messageState_st.followupState = TRUE");
		funcIDE_WaitForHalt(3000);
		
		TLTMaster_BZ = getSignal(signalname);
		funcIDE_ReadVariableAndCheck("(msgIn_st).TLT_BZ", TLTMaster_BZ); 	
		
		funcIDE_DeleteAllBP();
		funcIDE_Reset();
		func_Wait(1000);
		funcIDE_Run();
		func_Wait(3000);
	}
	
	
}
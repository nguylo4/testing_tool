/*@!Encoding:1252*/
/*

@requirement/s
[PO_01_RS_93638]
The function "TLT Customizing Function" shall «perform an End-To-End Communication Protection (E2E) acc. to PO_01_RS_85117 ff. for the following CAN send-messages:

TLT_Req_NR_xy	(xy = [01, 02, 03, 04])

using the following signals:

"TLT_Req_NR_01_CRC_XIX_TLT_Req_NR_01_XIX_FASCANFD1"
"TLT_Req_NR_01_BZ_XIX_TLT_Req_NR_01_XIX_FASCANFD1"
"TLT_Req_NR_02_CRC_XIX_TLT_Req_NR_02_XIX_FASCANFD1"
"TLT_Req_NR_02_BZ_XIX_TLT_Req_NR_02_XIX_FASCANFD1"
"TLT_Req_NR_03_CRC_XIX_TLT_Req_NR_03_XIX_FASCANFD2"
"TLT_Req_NR_03_BZ_XIX_TLT_Req_NR_03_XIX_FASCANFD2"
"TLT_Req_NR_04_CRC_XIX_TLT_Req_NR_04_XIX_FASCANFD2"
"TLT_Req_NR_04_BZ_XIX_TLT_Req_NR_04_XIX_FASCANFD2"

».
----------------------------------------------------------------------------------------------------------------------------------------------------------------
// @SW release : RC_CUST_DAS_VW_02_SW_V119.01.01
@date : Jan 23 2024
@author : Nguyen Loc
@observations : 
----------------------------------------------------------------------------------------------------------------------------------------------------------------
// @SW release : RC_CUST_DAS_VW_02_SW_U151.01.01
@date : June 19 2024
@author : Nguyen Loc
@observations : 
----------------------------------------------------------------------------------------------------------------------------------------------------------------
// @SW release : RC_CUST_DAS_VW_02_U154.01.01
@date : Sep 18 2024
@author : Nguyen Loc
@observations :
----------------------------------------------------------------------------------------------------------------------------------------------------------------
// @SW release : RC_CUST_DAS_VW_02_V155.01.01
@date : Sep 29 2024
@author : Nguyen Loc
@observations :
----------------------------------------------------------------------------------------------------------------------------------------------------------------
// @SW release : RC_CUST_DAS_VW_02_U172.01.01
@date : 16 Jan 2025
@author : Nguyen Loc
@observations :
----------------------------------------------------------------------------------------------------------------------------------------------------------------
// @SW release : RC_CUST_DAS_VW_02_U190.01.01
@date : May 07 2025
@author : Hua Truong
@observations :
----------------------------------------------------------------------------------------------------------------------------------------------------------------

@Test design
Case1:
set:
"DiagCodingPlattformVW02" == ['1: MQB37W']
check:
signal below is sent:
"TLT_Req_NR_01_CRC_XIX_TLT_Req_NR_01_XIX_FASCANFD1"
"TLT_Req_NR_01_BZ_XIX_TLT_Req_NR_01_XIX_FASCANFD1"
"TLT_Req_NR_02_CRC_XIX_TLT_Req_NR_02_XIX_FASCANFD1"
"TLT_Req_NR_02_BZ_XIX_TLT_Req_NR_02_XIX_FASCANFD1"
"TLT_Req_NR_03_CRC_XIX_TLT_Req_NR_03_XIX_FASCANFD2"
"TLT_Req_NR_03_BZ_XIX_TLT_Req_NR_03_XIX_FASCANFD2"
"TLT_Req_NR_04_CRC_XIX_TLT_Req_NR_04_XIX_FASCANFD2"
"TLT_Req_NR_04_BZ_XIX_TLT_Req_NR_04_XIX_FASCANFD2"

Case2:
set:
"DiagCodingPlattformVW02" == ['3: MEB']
check:
signal below is sent:
"TLT_Req_NR_01_CRC_XIX_TLT_Req_NR_01_XIX_FASCANFD1"
"TLT_Req_NR_01_BZ_XIX_TLT_Req_NR_01_XIX_FASCANFD1"
"TLT_Req_NR_02_CRC_XIX_TLT_Req_NR_02_XIX_FASCANFD1"
"TLT_Req_NR_02_BZ_XIX_TLT_Req_NR_02_XIX_FASCANFD1"
"TLT_Req_NR_03_CRC_XIX_TLT_Req_NR_03_XIX_FASCANFD2"
"TLT_Req_NR_03_BZ_XIX_TLT_Req_NR_03_XIX_FASCANFD2"
"TLT_Req_NR_04_CRC_XIX_TLT_Req_NR_04_XIX_FASCANFD2"
"TLT_Req_NR_04_BZ_XIX_TLT_Req_NR_04_XIX_FASCANFD2"

Case3:
set:
"DiagCodingPlattformVW02" == ['NOT CODED']
check:
signal below is NOT sent:
"TLT_Req_NR_01_CRC_XIX_TLT_Req_NR_01_XIX_FASCANFD1"
"TLT_Req_NR_01_BZ_XIX_TLT_Req_NR_01_XIX_FASCANFD1"
"TLT_Req_NR_02_CRC_XIX_TLT_Req_NR_02_XIX_FASCANFD1"
"TLT_Req_NR_02_BZ_XIX_TLT_Req_NR_02_XIX_FASCANFD1"
"TLT_Req_NR_03_CRC_XIX_TLT_Req_NR_03_XIX_FASCANFD2"
"TLT_Req_NR_03_BZ_XIX_TLT_Req_NR_03_XIX_FASCANFD2"
"TLT_Req_NR_04_CRC_XIX_TLT_Req_NR_04_XIX_FASCANFD2"
"TLT_Req_NR_04_BZ_XIX_TLT_Req_NR_04_XIX_FASCANFD2"

*/

testcase SwT_VW_02_10486()
{
    const int NUMBER_OF_TESTCASE = 2;
	const int time_to_check =5;
    int i, previous_CRC, previous_BZ, SensorID, NR, FD,Check_CRC,Check_BZ;
    char sig_BZ[255], sig_CRC[255], reportname[255], chtemp[255];

    // Preconditions
    funcIDE_DeleteAllBP();
    funcIDE_Reset();
    funcIDE_Run();
    func_Wait(2000);

    SensorID = funcIDE_ReadVariable("Rte_SensorId_SensorId_SensorId");

    // Determine NR and FD based on SensorID
    switch (SensorID) {
        case 0: 
		case 8:
            NR = 3; FD = 2; break;
        case 1: 
		case 9:
            NR = 4; FD = 2; break;
        case 2:
            NR = 1; FD = 1; break;
        case 3:
            NR = 2; FD = 1; break;
        default:
            NR = 0; FD = 0; // Handle default case as needed
    }

    snprintf(reportname, 255, "X:\\30_Reports\\Cust\\SwT_VW_02_10486_ECU%d", SensorID);
    testReportFileName(reportname);
    TestCaseTitle("SwT_VW_02_10486", "Check signal TLT_Rep is sent correctly");

    snprintf(sig_CRC, 255, "TLT_Req_NR_0%d_CRC_XIX_TLT_Req_NR_0%d_XIX_FASCANFD%d", NR, NR, FD);
    snprintf(sig_BZ, 255, "TLT_Req_NR_0%d_BZ_XIX_TLT_Req_NR_0%d_XIX_FASCANFD%d", NR, NR, FD);
	testStep("+++", "+++ SECTION: ------------------------------------CASE 1 for ECU%d------------------------------------", SensorID);

    for (i = 0; i < time_to_check; i++) {
        testStep("+++", "+++ -----------------------------check %d times-------------------------", i+1);
		funcIDE_WriteVariable("Rte_Coding_Coding_Data.platform_en",1); // MQB coding
		
        previous_CRC = getsignal(sig_CRC);
        previous_BZ = getsignal(sig_BZ);
        func_Wait(3000);
        
        Check_CRC = getsignal(sig_CRC);
        Check_BZ = getsignal(sig_BZ);
        testStep("+++", "Previous: CRC= %d, BZ= %d", previous_CRC, previous_BZ);
        testStep("+++", "After:  CRC= %d, BZ= %d", Check_CRC, Check_BZ);
		func_ValueCompare("Check CRC is count: ",previous_CRC ,Check_CRC, not_equal);
		func_ValueCompare("Check BZ is count: ",previous_BZ ,Check_BZ, not_equal);
		funcIDE_ReadVariableandcheck("Rte_Coding_Coding_Data.platform_en",1, equal); // MQB coding
        // Clean Testcase
        funcIDE_DeleteAllBP();
        funcIDE_Reset();
        funcIDE_Run();
        func_Wait(2000);
    }

	testStep("+++", "+++ SECTION: ------------------------------------CASE 2 for ECU%d------------------------------------", SensorID);

	for (i = 0; i < time_to_check; i++) {
        testStep("+++", "+++ -----------------------------check %d times-------------------------", i+1);
		funcIDE_WriteVariable("Rte_Coding_Coding_Data.platform_en",3); // MEB coding
		
        previous_CRC = getsignal(sig_CRC);
        previous_BZ = getsignal(sig_BZ);
        func_Wait(3000);
        
        Check_CRC = getsignal(sig_CRC);
        Check_BZ = getsignal(sig_BZ);
        testStep("+++", "Previous: CRC= %d, BZ= %d", previous_CRC, previous_BZ);
        testStep("+++", "After:  CRC= %d, BZ= %d", Check_CRC, Check_BZ);
		func_ValueCompare("Check CRC is count: ",previous_CRC ,Check_CRC, not_equal);
		func_ValueCompare("Check BZ is count: ",previous_BZ ,Check_BZ, not_equal);
		funcIDE_ReadVariableandcheck("Rte_Coding_Coding_Data.platform_en",3, equal); // MEB coding
        // Clean Testcase
        funcIDE_DeleteAllBP();
        funcIDE_Reset();
        funcIDE_Run();
        func_Wait(2000);
    }

    testStep("+++", "+++ SECTION: ------------------------------------CASE 3 for ECU%d------------------------------------", SensorID);

	for (i = 0; i < time_to_check; i++) {
        testStep("+++", "+++ -----------------------------check %d times-------------------------", i+1);
		funcIDE_WriteVariable("Rte_Coding_Coding_Data.platform_en",0); //NOT CODED
		
        previous_CRC = getsignal(sig_CRC);
        previous_BZ = getsignal(sig_BZ);
        func_Wait(3000);
        
        Check_CRC = getsignal(sig_CRC);
        Check_BZ = getsignal(sig_BZ);
        testStep("+++", "Previous: CRC= %d, BZ= %d", previous_CRC, previous_BZ);
        testStep("+++", "After:  CRC= %d, BZ= %d", Check_CRC, Check_BZ);
		func_ValueCompare("Check CRC is count: ",previous_CRC ,Check_CRC, equal);
		func_ValueCompare("Check BZ is count: ",previous_BZ ,Check_BZ, equal);
		funcIDE_ReadVariableandcheck("Rte_Coding_Coding_Data.platform_en",0, equal); //NOT CODED
        // Clean Testcase
        funcIDE_DeleteAllBP();
        funcIDE_Reset();
        funcIDE_Run();
        func_Wait(2000);
    }
	

    // Clean Testcase
    func_testStepSubSection("Clean Testcase");
    funcIDE_DeleteAllBP();
    funcIDE_Reset();
    funcIDE_Run();
}

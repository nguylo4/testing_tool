/*@!Encoding:1252*/
includes
{
  
}

variables
{
  
}

/*

@requirement/s

[PO_01_RS_102018]
The function "Diag UDS Processing" shall «set "Diag_CalibrationNotPerformedError" as 'NotDetected'  if the following conditions are met
	 AAC_AzimuthAutoalignmentCustomerCalibrationProgress is available max. 2s after StartUp. //2s is elapsed after step_1 (PO_01_RS_102017)
AND
	"AAC_AzimuthAutoalignmentCustomerCalibrationProgress" == 100%
------------------------------------------------------------------------------------------------------------------------------------------------
@SW release:    RC_CUST_DAS_VW_02_SW_U190.01.01
@author:     	MinhTien Tran
@date:      	09/05/2025
------------------------------------------------------------------------------------------------------------------------------------------------
@design :	
CASE 1: (Same as Software Test Scenario 1 on H_TestCriterion)
SET:
	Step 1 is precondition:
		"Diag_CalibrationFinished_CFG" = 'true'
		"DiagVarCalibrationResetPerformed" = 'true
	Wait 2s after StartUp
	"AAC_AzimuthAutoalignmentCustomerCalibrationProgress"  is available max = 100%
CHECK:
	"Diag_CalibrationNotPerformedError" := 'NotDetected'
	
CASE 2:(Negative)  (Same as Software Test Scenario 2 on H_TestCriterion of Requirement 102019)
SET:
	Step 1 is precondition:
		"Diag_CalibrationFinished_CFG" = 'true'
		"DiagVarCalibrationResetPerformed" = 'true
	Wait 2s after StartUp
	"AAC_AzimuthAutoalignmentCustomerCalibrationProgress"  is available but  < 100% (=90%)
CHECK:
	"Diag_CalibrationNotPerformedError" := 'Detected'  //(Based on ELSE case of Requirement 102019)

CASE 3:(Negative) 
SET:
	Step 1 is precondition:
		"Diag_CalibrationFinished_CFG" = 'true'
		"DiagVarCalibrationResetPerformed" = 'true
	Wait 2s after StartUp
	"AAC_AzimuthAutoalignmentCustomerCalibrationProgress"  is NOT available
CHECK:
	"Diag_CalibrationNotPerformedError" := 'Detected'  //(Based on ELSE case of Requirement 102019)


Note: 
Negative case for  AAC_AzimuthAutoalignmentCustomerCalibrationProgress (is) (is not) available LESS than 2s after StartUp is ignored due to these two conditions are combined and complement each other, so it's not possible for testing (aligned with Dev and SE)
*/

testcase SwT_VW_02_13793()
{
	char chTemp[255]="";
	const int NUMBER_OF_TESTCASE = 3;
	int i, SensorID,pre_result;
	
	int ipt1Val[NUMBER_OF_TESTCASE] = {100, 90, 100}; //Diag_CalibrationFinished_CFG
	int ipt2Val[NUMBER_OF_TESTCASE] = {1, 1, 0}; //DiagVarCalibrationResetPerformed
	
	int opt1Val[NUMBER_OF_TESTCASE] = {1, 2, 2}; //Diag_CalibrationNotPerformedError
	
    TestCaseTitle("SwT_VW_02_13793","Check if depending of the calibration ends without an error and AAC_AzimuthAutoalignmentCustomerCalibrationProgress/Diag_calibrationFinished,DiagVarCAlibrationResetPerformed are set correctlyt then the Diag_calibrationNotPerformedError is set correctly");
	testReportFileName("X:\\30_Reports\\Diag\\SwT_VW_02_13793");
	//********************************************* Preconditions *********************************************
    funcIDE_DeleteAllBP();
    funcIDE_Reset();
	func_Wait(2000);
	funcIDE_Run();
    func_Wait(3000);
 
	funcIDE_ReadVariable("Rte_SensorId_SensorId_SensorId");
    func_Wait(1000);
 /* **************** End Preconditions ******************/

  	for (i=0;i<NUMBER_OF_TESTCASE;i++)
	{
		testStep("+++" , "+++ SECTION: ------------------------------------CASE %d------------------------------------", i + 1);
		
		funcWinIdea_SetBPSource("DiagMdw_CheckCalibrationError","if ((TRUE == DiagMdw_Customer_Rw_NonDataset_st.DiagCalibrationFinished_uint8)");
		funcIDE_Reset();
		funcIDE_Run();
		funcIDE_WaitForHalt(5000);  
		funcIDE_ReadVariableandCheck("(EventMdw_ErrorResult_ast[EVHND_EVENT_DIAG_CALIBRATIONNOTPERFORMED]).testResultRaw_u8", 0); // Check Init_ Not_Tested
		func_Wait(200);
		funcIDE_DeleteAllBP();
		
		funcWinIdea_SetBPSource("EventMdw_ErrorResult_ast","CheckUpdated_b = Rte_IsUpdated_Aac_Data_Data()");
		funcIDE_Run();
		funcIDE_WaitForHalt(5000);
		funcIDE_ReadVariableandCheck("DiagMdw_Customer_Rw_NonDataset_st.DiagCalibrationFinished_uint8", 1);
		funcIDE_ReadVariableandCheck("tmp_CalibrationResetPerformed_b", 1);
		func_Wait(200);
		funcIDE_WriteVariable("Rte_Core0AsilB_RxUpdateFlags.Rte_RxUpdate_DiagMdwAsilB_Aac_Data_Data", 0);
		funcIDE_WriteVariable("Rte_Core1AsilB_RxUpdateFlags.Rte_RxUpdate_DiagMdwAsilB_Aac_Data_Data_Sender", 1);
		func_Wait(500);
		funcWinIdea_SetBPSource("EventMdw_ErrorResult_ast","retVal_u8 = Rte_Read_Aac_Data_Data(&Aac_Data_st)");
		funcIDE_Run();
		funcIDE_WaitForHalt(5000);
		funcIDE_WriteVariable("(Rte_Aac_Aac_Data_Data).customerCalibrationProgress_u8", ipt1Val[i]); // write customerCalibrationProgress_u8
		func_Wait(200);
		funcIDE_WriteVariable("Rte_Core1AsilB_RxNeverReceivedFlags.Rte_RxNeverReceived_Aac_Aac_Data_Data", ipt2Val[i]); // write "AAC_AzimuthAutoalignmentCustomerCalibrationProgress" is available or not
		func_Wait(200);
		
		funcWinIdea_SetBPSource("DiagMdw_CheckCalibrationError","if ((TRUE == DiagMdw_Customer_Rw_NonDataset_st.DiagCalibrationFinished_uint8)");
		funcIDE_Run();
		funcIDE_WaitForHalt(5000);  
		funcIDE_ReadVariableandCheck("(EventMdw_ErrorResult_ast[EVHND_EVENT_DIAG_CALIBRATIONNOTPERFORMED]).testResultRaw_u8", opt1Val[i]); 
		func_Wait(200);
	
		funcIDE_DeleteAllBP();
		funcIDE_Reset();
		funcIDE_Run();
		func_Wait(2000);
		
	}
/***********************************************************************************************************************************************
 * END
 ***********************************************************************************************************************************************/

	func_testStepSubSection("Clean Testcase");
	funcIDE_DeleteAllBP();
	funcIDE_Reset();
	funcIDE_Run();
	func_Wait(2000);
	
}

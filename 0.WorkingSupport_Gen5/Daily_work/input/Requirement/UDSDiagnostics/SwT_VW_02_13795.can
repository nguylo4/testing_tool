/*@!Encoding:1252*/
includes
{
  
}

variables
{
  
}

/*

@requirement/s

[PO_01_RS_102019]
The function "Diag UDS Processing" shall «set "Diag_CalibrationNotPerformedError" as follows:

//Step_2: Plausibility with ACC Progress Input.
IF
	AAC_AzimuthAutoalignmentCustomerCalibrationProgress is available more than 2s after StartUp. //2s is elapsed after step_1 (PO_01_RS_102017)
AND
	"SysStM_StateInfo" != 'ApplSW_ACTIVE
THEN
	"Diag_CalibrationNotPerformedError" := 'NotDetected'
ELSE
	"Diag_CalibrationNotPerformedError" := 'Detected'
».
//Hint:  shall be performed in DiagMdw_Main(), note that the "AAC_AzimuthAutoalignmentCustomerCalibrationProgress" shall be read from "Rte_Read_Aac_Data_Data".
------------------------------------------------------------------------------------------------------------------------------------------------
@SW release:    RC_CUST_DAS_VW_02_SW_U190.01.01
@author:     	MinhTien Tran
@date:      	09/05/2025
------------------------------------------------------------------------------------------------------------------------------------------------
@design :	
CASE 1: 
SET:
	Step 1 is precondition:
		"Diag_CalibrationFinished_CFG" = 'true'
		"DiagVarCalibrationResetPerformed" = 'true
	"AAC_AzimuthAutoalignmentCustomerCalibrationProgress" is available max. 2s after StartUp = 100%
	"SysStM_StateInfo" != 'ApplSW_ACTIVE
CHECK:
	"Diag_CalibrationNotPerformedError" := 'NotDetected'
	
CASE 2: 
SET:
	Step 1 is precondition:
		"Diag_CalibrationFinished_CFG" = 'true'
		"DiagVarCalibrationResetPerformed" = 'true
	"AAC_AzimuthAutoalignmentCustomerCalibrationProgress" is available max. 2s after StartUp = 100%
	"SysStM_StateInfo" = 'ApplSW_ACTIVE
CHECK:
	"Diag_CalibrationNotPerformedError" := 'Detected'


CASE 3:(Negative)  (Same as Software Test Scenario 1 on H_TestCriterion)
SET:
	Step 1 is precondition:
		"Diag_CalibrationFinished_CFG" = 'true'
		"DiagVarCalibrationResetPerformed" = 'true
	Check1:
		 "Diag_CalibrationNotPerformedError" := 'NotDetected'
	"AAC_AzimuthAutoalignmentCustomerCalibrationProgress" is available 2s after StartUp but < 100% (90%)
CHECK:
	"Diag_CalibrationNotPerformedError" := 'Detected'

CASE 4:(Negative)  (Same as Software Test Scenario 2 on H_TestCriterion)
SET:
	Step 1 is precondition:
		"Diag_CalibrationFinished_CFG" = 'true'
		"DiagVarCalibrationResetPerformed" = 'true
	"AAC_AzimuthAutoalignmentCustomerCalibrationProgress" is not sent  by AAC
	"SysStM_StateInfo" != 'ApplSW_ACTIVE
	Wait 2s after StartUp
CHECK:
	"Diag_CalibrationNotPerformedError" := 'NotDetected'
	
CASE 5:(Negative)  (Same as Software Test Scenario 3 on H_TestCriterion)
SET:
	Step 1 is precondition:
		"Diag_CalibrationFinished_CFG" = 'true'
		"DiagVarCalibrationResetPerformed" = 'true
	"AAC_AzimuthAutoalignmentCustomerCalibrationProgress" is not sent  by AAC
	"SysStM_StateInfo" = 'ApplSW_ACTIVE
	Wait 2s after StartUp
CHECK:
    "Diag_CalibrationNotPerformedError" := 'Detected'
*/

testcase SwT_VW_02_13795()
{
	char chTemp[255]="";
	const int NUMBER_OF_TESTCASE = 5;
	int i, SensorID,pre_result;
	
	int ipt1Val[NUMBER_OF_TESTCASE] = {100, 100, 90, 100, 100}; //customerCalibrationProgress_u8
	int ipt2Val[NUMBER_OF_TESTCASE] = {1, 1, 1, 0, 0}; //AAC_AzimuthAutoalignmentCustomerCalibrationProgress
	int ipt3Val[NUMBER_OF_TESTCASE] = {3, 1, 1, 3, 1}; //Rte_SysStM_SystemState_Data
	
	int opt1Val[NUMBER_OF_TESTCASE] = {1, 2, 2, 1, 2}; //Diag_CalibrationNotPerformedError
	
    TestCaseTitle("SwT_VW_02_13795","Check if depending of the calibration ends without an error and AAC_AzimuthAutoalignmentCustomerCalibrationProgress/Diag_calibrationFinished,DiagVarCAlibrationResetPerformed are set correctlyt then the Diag_calibrationNotPerformedError is set correctly");
	testReportFileName("X:\\30_Reports\\Diag\\SwT_VW_02_13795");
	//********************************************* Preconditions *********************************************
    funcIDE_DeleteAllBP();
    funcIDE_Reset();
	func_Wait(2000);
	funcIDE_Run();
    func_Wait(3000);
 
	funcIDE_ReadVariable("Rte_SensorId_SensorId_SensorId");
    func_Wait(1000);
 /* **************** End Preconditions ******************/

  	for (i=0;i<NUMBER_OF_TESTCASE;i++)
	{
		testStep("+++" , "+++ SECTION: ------------------------------------CASE %d------------------------------------", i + 1);
		
		funcWinIdea_SetBPSource("DiagMdw_CheckCalibrationError","if ((TRUE == DiagMdw_Customer_Rw_NonDataset_st.DiagCalibrationFinished_uint8)");
		funcIDE_Reset();
		funcIDE_Run();
		funcIDE_WaitForHalt(5000);  
		funcIDE_ReadVariableandCheck("(EventMdw_ErrorResult_ast[EVHND_EVENT_DIAG_CALIBRATIONNOTPERFORMED]).testResultRaw_u8", 0); // Check Init_ Not_Tested
		func_Wait(200);
		funcIDE_DeleteAllBP();
		
		funcWinIdea_SetBPSource("EventMdw_ErrorResult_ast","CheckUpdated_b = Rte_IsUpdated_Aac_Data_Data()");
		funcIDE_Run();
		funcIDE_WaitForHalt(5000);
		funcIDE_ReadVariableandCheck("DiagMdw_Customer_Rw_NonDataset_st.DiagCalibrationFinished_uint8", 1);
		funcIDE_ReadVariableandCheck("tmp_CalibrationResetPerformed_b", 1);
		func_Wait(200);
		// Lack of implementation for SysStM_StateInfo
		funcIDE_ReadVariableandCheck("Rte_SysStM_SystemState_Data", ipt3Val[i]);
	
		funcIDE_WriteVariable("Rte_Core0AsilB_RxUpdateFlags.Rte_RxUpdate_DiagMdwAsilB_Aac_Data_Data", 0);
		funcIDE_WriteVariable("Rte_Core1AsilB_RxUpdateFlags.Rte_RxUpdate_DiagMdwAsilB_Aac_Data_Data_Sender", 1);
		func_Wait(500);
		funcWinIdea_SetBPSource("EventMdw_ErrorResult_ast","retVal_u8 = Rte_Read_Aac_Data_Data(&Aac_Data_st)");
		funcIDE_Run();
		funcIDE_WaitForHalt(5000);
		funcIDE_WriteVariable("(Rte_Aac_Aac_Data_Data).customerCalibrationProgress_u8", ipt1Val[i]); // write customerCalibrationProgress_u8
		func_Wait(200);
		funcIDE_WriteVariable("Rte_Core1AsilB_RxNeverReceivedFlags.Rte_RxNeverReceived_Aac_Aac_Data_Data", ipt2Val[i]); // write "AAC_AzimuthAutoalignmentCustomerCalibrationProgress" is available or not
		func_Wait(200);
		
		funcWinIdea_SetBPSource("DiagMdw_CheckCalibrationError","if ((TRUE == DiagMdw_Customer_Rw_NonDataset_st.DiagCalibrationFinished_uint8)");
		funcIDE_Run();
		funcIDE_WaitForHalt(5000);  
		funcIDE_ReadVariableandCheck("(EventMdw_ErrorResult_ast[EVHND_EVENT_DIAG_CALIBRATIONNOTPERFORMED]).testResultRaw_u8", opt1Val[i]); 
		func_Wait(200);
	
		funcIDE_DeleteAllBP();
		funcIDE_Reset();
		funcIDE_Run();
		func_Wait(2000);
		
	}
/***********************************************************************************************************************************************
 * END
 ***********************************************************************************************************************************************/

	func_testStepSubSection("Clean Testcase");
	funcIDE_DeleteAllBP();
	funcIDE_Reset();
	funcIDE_Run();
	func_Wait(2000);
	
}

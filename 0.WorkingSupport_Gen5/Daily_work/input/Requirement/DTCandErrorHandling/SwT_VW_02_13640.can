/*@!Encoding:65001*/
includes {

}

variables {

}

/*
************************************************************************************************************************************************
*INFORMATION
************************************************************************************************************************************************
@brief:			Check if the function DTC DatasetOverallErrorDetection will calculate HellaDatasetInvalid, HellaDatasetImplausible

------------------------------------------------------------------------------------------------------------------------------------------------
@SW release:    U172.01.01
 @Author: 		Hoang Viet
 @Date: 		10/01/2025	
------------------------------------------------------------------------------------------------------------------------------------------------
@SW release : DAS_VW_02_SW_U174.01.01
@date : 18 Feb 2025
@modified by : Ly Nhi
------------------------------------------------------------------------------------------------------------------------------------------------
@SW release : RC_CUST_DAS_VW_02_SW_U190.01.01
@date : 07/05/2025
@author : Hoang Viet
@observations :
@requirement/s
------------------------------------------------------------------------------------------------------------------------------------------------

@requirement/s
------------------------------------------------------------------------------------------------------------------------------------------------
[PO_01_RS_100295]
The function "DTC DatasetOverallErrorDetection" shall « calculate "DTC_DatasetInvalidOverallError" and "DTC_DatasetImplausibleOverallError" as follows:

IF
	("Cust_WAI_DatasetInvalid" == 'True' || "DTC_HellaDatasetInvalid" == 'True')
THEN
	"DTC_DatasetInvalidOverallError" := 'Detected',
	"DTC_DatasetImplausibleOverallError" := 'NotDetected'.
	"NVRAM_DSUpdateIncompleteError" := 'Detected'.
ELSE IF
	("Cust_WAI_DatasetImplausible" == 'True' || "DTC_HellaDatasetImplausible" == 'True')
THEN
	"DTC_DatasetImplausibleOverallError" := 'Detected',
	"DTC_DatasetInvalidOverallError" := 'NotDetected'.
	"NVRAM_DSUpdateIncompleteError" := 'NotDetected'.
ELSE
	"DTC_DatasetInvalidOverallError" := 'NotDetected',
	"DTC_DatasetImplausibleOverallError" := 'NotDetected'.
».
------------------------------------------------------------------------------------------------------------------------------------------------
@Test design
------------------------------------------------------------------------------------------------------------------------------------------------
Case 1:
- Set:
	"Cust_WAI_DatasetInvalid" == 'True'
	"DTC_HellaDatasetInvalid" <> 'True'
- Check:
	"DTC_DatasetInvalidOverallError" := 'Detected',
	"DTC_DatasetImplausibleOverallError" := 'NotDetected'.
	"NVRAM_DSUpdateIncompleteError" := 'Detected'.
	
Case 2:
- Set:
	"Cust_WAI_DatasetInvalid" <> 'True'
	"DTC_HellaDatasetInvalid" == 'True'
- Check:
	"DTC_DatasetInvalidOverallError" := 'Detected',
	"DTC_DatasetImplausibleOverallError" := 'NotDetected'
	"NVRAM_DSUpdateIncompleteError" := 'Detected'.
	
Case 3:
- Set:
	"Cust_WAI_DatasetInvalid" <> 'True'
	"DTC_HellaDatasetInvalid" <> 'True'
	
	"Cust_WAI_DatasetImplausible" <> 'True'
	"DTC_HellaDatasetImplausible" == 'True'
- Check:
	"DTC_DatasetImplausibleOverallError" := 'Detected',
	"DTC_DatasetInvalidOverallError" := 'NotDetected'
	"NVRAM_DSUpdateIncompleteError" := 'NotDetected'.
	
Case 4:
- Set:
	"Cust_WAI_DatasetInvalid" <> 'True'
	"DTC_HellaDatasetInvalid" <> 'True'
	
	"Cust_WAI_DatasetImplausible" == 'True'
	"DTC_HellaDatasetImplausible" <> 'True'
- Check:
	"DTC_DatasetImplausibleOverallError" := 'Detected',
	"DTC_DatasetInvalidOverallError" := 'NotDetected'
	"NVRAM_DSUpdateIncompleteError" := 'NotDetected'.
	
Case 5:
- Set:
	"Cust_WAI_DatasetInvalid" <> 'True'
	"DTC_HellaDatasetInvalid" <> 'True'
	
	"Cust_WAI_DatasetImplausible" <> 'True'
	"DTC_HellaDatasetImplausible" <> 'True'
- Check:
	"DTC_DatasetInvalidOverallError" := 'NotDetected',
	"DTC_DatasetImplausibleOverallError" := 'NotDetected'
*/
testcase SwT_VW_02_13640()
{
	const NUMBER_OF_TESTCASE = 5;
    int i;
	const EVHND_EVENT_DSH_DSCRCFAILURE = 317;
	const EVHND_EVENT_DSH_DSCONFIGURATIONNOTFOUND = 319;
	const EVHND_EVENT_DSH_DSCONSISTENCE = 318;
	const EVHND_EVENT_DSH_DSINTERNAL = 320;
	const EVHND_EVENT_DSH_DSPARSINGSTOPPED = 321;
	const EVHND_EVENT_MLM_DSSTRUCTUREVERSION = 322;
	const EVHND_EVENT_HELLA_DATASET_DFLT_DATA_ACTIVE = 58;
	
	

	/* Input*/	
		char ipt1[255] = "Eventmdw_SendDataset_st.Invalid_b";
		char ipt2[255] = "Eventmdw_SendDataset_st.Implausible_b";
		char ipt3[255] = "Rte_Core0AsilB_RxUpdateFlags.Rte_RxUpdate_EventMdw_AstechDatasetStatus_Data";
		char ipt4[255] = "((EventMdw_ErrorResult_ast)[EVHND_EVENT_DSH_DSCRCFAILURE]).debounceResult_u8";
		char ipt5[255] = "((EventMdw_ErrorResult_ast)[EVHND_EVENT_DSH_DSCONFIGURATIONNOTFOUND]).debounceResult_u8";
		char ipt6[255] = "((EventMdw_ErrorResult_ast)[EVHND_EVENT_DSH_DSCONSISTENCE]).debounceResult_u8";
		char ipt7[255] = "((EventMdw_ErrorResult_ast)[EVHND_EVENT_DSH_DSINTERNAL]).debounceResult_u8";
		char ipt8[255] = "((EventMdw_ErrorResult_ast)[EVHND_EVENT_DSH_DSPARSINGSTOPPED]).debounceResult_u8";
		char ipt9[255] = "((EventMdw_ErrorResult_ast)[EVHND_EVENT_MLM_DSSTRUCTUREVERSION]).debounceResult_u8";
		char ipt10[255] = "((EventMdw_ErrorResult_ast)[EVHND_EVENT_HELLA_DATASET_DFLT_DATA_ACTIVE]).debounceResult_u8";
		char ipt11[255] = "(Rte_WAA_CONT_DatasetStatus_Data).WaAstech_DatasetInvalid_b";
		char ipt12[255] = "(Rte_WAA_CONT_DatasetStatus_Data).WaAstech_DatasetImplausible_b";
		
	/* Output*/	
		char opt1[255] = "Eventmdw_SendDataset_st.Invalid_b"; 
		char opt2[255] = "Eventmdw_SendDataset_st.Implausible_b"; 	
		char opt3[255] = "Eventmdw_DatasetStatus_flag_b"; 
		char opt4[255] = "Event_Error_Status_st[EVHND_EVENT_DSH_DSCRCFAILURE].debounceResult_u8";
		char opt5[255] = "Event_Error_Status_st[EVHND_EVENT_DSH_DSCONFIGURATIONNOTFOUND].debounceResult_u8";
		char opt6[255] = "Event_Error_Status_st[EVHND_EVENT_DSH_DSCONSISTENCE].debounceResult_u8";
		char opt7[255] = "Event_Error_Status_st[EVHND_EVENT_DSH_DSINTERNAL].debounceResult_u8";
		char opt8[255] = "Event_Error_Status_st[EVHND_EVENT_DSH_DSPARSINGSTOPPED].debounceResult_u8";
		char opt9[255] = "Event_Error_Status_st[EVHND_EVENT_MLM_DSSTRUCTUREVERSION].debounceResult_u8";
		char opt10[255]= "Event_Error_Status_st[EVHND_EVENT_HELLA_DATASET_DFLT_DATA_ACTIVE].debounceResult_u8";
		char opt11[255]= "((EventMdw_ErrorResult_ast)[EVHND_EVENT_DATASET_INVALID_OVERALL]).testResultRaw_u8";
		char opt13[255]= "((EventMdw_ErrorResult_ast)[EVHND_EVENT_DATASET_IMPLAUSIBLE_OVERALL]).testResultRaw_u8";
		char opt14[255]= "((EventMdw_ErrorResult_ast)[EVHND_EVENT_DS_UPDATE_INCOMPLETE]).testResultRaw_u8";
		

	/* Input_Value*/						
		int ipt1Val[NUMBER_OF_TESTCASE] =  {2, 2, 2, 2, 2}; // Set init value of Eventmdw_SendDataset_st.Invalid_b
		int ipt2Val[NUMBER_OF_TESTCASE] =  {2, 2, 2, 2, 2}; // Set init value of Eventmdw_SendDataset_st.Implausible_b
		int ipt3Val[NUMBER_OF_TESTCASE] =  {0, 0, 0, 0, 0};
		int ipt4Val[NUMBER_OF_TESTCASE] =  {0, 2, 0, 1, 1};
		int ipt5Val[NUMBER_OF_TESTCASE] =  {2, 0, 0, 1, 1};
		int ipt6Val[NUMBER_OF_TESTCASE] =  {0, 0, 2, 1, 1};
		int ipt7Val[NUMBER_OF_TESTCASE] =  {0, 0, 0, 0, 0};
		int ipt8Val[NUMBER_OF_TESTCASE] =  {0, 0, 0, 0, 0};
		int ipt9Val[NUMBER_OF_TESTCASE] =  {0, 0, 0, 0, 0};
		int ipt10Val[NUMBER_OF_TESTCASE] = {1, 1, 1, 1, 1};
		int ipt11Val[NUMBER_OF_TESTCASE] = {1, 0, 0, 0, 0};
		int ipt12Val[NUMBER_OF_TESTCASE] = {1, 0, 1, 1, 0};
                                            
	/* Output_Value*/		                
        int opt1Val[NUMBER_OF_TESTCASE] =  {2, 1, 2, 0, 0};
		int opt2Val[NUMBER_OF_TESTCASE] =  {1, 2, 1, 0, 0};
		int opt3Val[NUMBER_OF_TESTCASE] =  {1, 1, 1, 1, 1};
		int opt4Val[NUMBER_OF_TESTCASE] =  {0, 2, 0, 1, 1};
		int opt5Val[NUMBER_OF_TESTCASE] =  {2, 0, 0, 1, 1};
		int opt6Val[NUMBER_OF_TESTCASE] =  {0, 0, 2, 1, 1};
		int opt7Val[NUMBER_OF_TESTCASE] =  {0, 0, 0, 0, 0};
		int opt8Val[NUMBER_OF_TESTCASE] =  {0, 0, 0, 0, 0};
		int opt9Val[NUMBER_OF_TESTCASE] =  {0, 0, 0, 0, 0};
		int opt10Val[NUMBER_OF_TESTCASE] = {1, 1, 1, 1, 1};
		int opt11Val[NUMBER_OF_TESTCASE] = {2, 2, 1, 1, 1};
		int opt13Val[NUMBER_OF_TESTCASE] = {1, 1, 2, 2, 1};
		int opt14Val[NUMBER_OF_TESTCASE] = {2, 2, 1, 1, 1};

	TestCaseTitle("SwT_VW_02_13640","Check if the function DTC DatasetOverallErrorDetection will calculate HellaDatasetInvalid, HellaDatasetImplausible");
    testReportFileName("X:\\30_Reports\\DTC\\SwT_VW_02_13640");

    //********************************************* Preconditions *********************************************
    func_testStepSubSection("Reset the environment");
    funcIDE_DeleteAllBP();
    funcIDE_Reset();
	func_Wait(1000);
    funcIDE_Run();
    func_Wait(3000);
    
    //********************************************* Test Body ************************************************   
	for ( i = 0; i < NUMBER_OF_TESTCASE; i++)
	{
		testStep("+++" , "+++ SECTION: ------------------------------------CASE %d------------------------------------", i+1);
		
		funcWinIdea_SetBPSource("Eventmdw_DTC_DatasetOverallErrorDetection","if (TRUE == Rte_IsUpdated_AstechDatasetStatus_Data())");
		funcIDE_WaitForHalt(5000);
		funcIDE_WriteVariable(ipt1, ipt1Val[i]);
		funcIDE_WriteVariable(ipt2, ipt2Val[i]);
		funcIDE_WriteVariable(ipt3, ipt3Val[i]);
		func_wait(200);
		funcIDE_WriteVariable(ipt4, ipt4Val[i]);
		funcIDE_WriteVariable(ipt5, ipt5Val[i]);
		funcIDE_WriteVariable(ipt6, ipt6Val[i]);
		func_wait(200);
		funcIDE_WriteVariable(ipt7, ipt7Val[i]);
		funcIDE_WriteVariable(ipt8, ipt8Val[i]);
		funcIDE_WriteVariable(ipt9, ipt9Val[i]);
		func_wait(200);
		funcIDE_WriteVariable(ipt10, ipt10Val[i]);
		funcIDE_WriteVariable(ipt11, ipt11Val[i]);
		funcIDE_WriteVariable(ipt12, ipt12Val[i]);
		func_wait(200);
		
		funcWinIdea_SetBPSource("Eventmdw_DTC_DatasetOverallErrorDetection","if ((TRUE == Eventmdw_DatasetStatus_flag_b) &&");
		funcIDE_Run();
		funcIDE_WaitForHalt(5000);
		funcIDE_ReadVariableAndCheck(opt3, opt3Val[i]);
		funcIDE_ReadVariableAndCheck(opt4, opt4Val[i]);
		funcIDE_ReadVariableAndCheck(opt5, opt5Val[i]);
		func_wait(200);
		funcIDE_ReadVariableAndCheck(opt6, opt6Val[i]);
		funcIDE_ReadVariableAndCheck(opt7, opt7Val[i]);
		funcIDE_ReadVariableAndCheck(opt8, opt8Val[i]);
		func_wait(200);
		funcIDE_ReadVariableAndCheck(opt9, opt9Val[i]);
		funcIDE_ReadVariableAndCheck(opt10, opt10Val[i]);
		
		// funcWinIdea_SetBPSource("Eventmdw_DTC_DatasetOverallErrorDetection","if (RTE_E_OK == retVal_u8)");
		func_wait(200);
		funcIDE_SetBPLine(2183,"Y:/Source/EventMiddleware/Variant_DAS_VW_02/EventMdw_OEM_Specific.c");
		funcIDE_Run();
		funcIDE_WaitForHalt(5000);
		
		funcIDE_ReadVariableAndCheck(opt1, opt1Val[i]);
		funcIDE_ReadVariableAndCheck(opt2, opt2Val[i]);
		func_wait(200);
		funcIDE_DeleteAllBP();
		
		funcWinIdea_SetBPSource("Eventmdw_DTC_DatasetOverallErrorDetection","if (TRUE == Rte_IsUpdated_AstechDatasetStatus_Data())");
		funcIDE_Run();
		funcIDE_WaitForHalt(5000);
		funcIDE_Run();
		funcIDE_WaitForHalt(5000);
		funcIDE_ReadVariableAndCheck(opt11, opt11Val[i]);
		funcIDE_ReadVariableAndCheck(opt13, opt13Val[i]);
		if(i!=4)
		{
			funcIDE_ReadVariableAndCheck(opt14, opt14Val[i]);
		}
		func_wait(200);
		
		func_testStepSubSection("Clean Testcase");
		funcIDE_DeleteAllBP();
		funcIDE_Reset();
		func_Wait(1000);
		funcIDE_Run();
		func_Wait(2000);
    }
}